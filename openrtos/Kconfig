## openrtos/Kconfig
```kconfig
#
# For a description of the syntax of this configuration file,
# see Documentation/kbuild/kconfig-language.txt.
#

menu "OpenRTOS"
        hidden if DEV_DEVELOP

config GCC_LTO
    bool "GCC LTO enable"
    depends on CPU_FA626 || CPU_RISCV
    default y if (DEV_RELEASE && (CPU_FA626 || CPU_RISCV))
    default n if DEV_DEVELOP
    help
        Link Time Optimization. Recommends disabled on develop time to save build time.
        Enabled on release time to reduce ROM image size.

    help_cht
        開啟 GCC LTO (Link time optimization)。Linking 的時間會較久，但執行碼會較小，也較有效率。

    help_chs
        开启 GCC LTO (Link time optimization)。Linking 的时间会较久，但执行码会较小，也较有效率。

config OPENRTOS_HEAP_SIZE
    string "The size of individual heap size"
    default "0"
    help
        The size of individual heap size. 0 indicates to use global heap management.
    help_cht
        單獨切給作業系統使用的記憶體大小， 0表示不切割。
    help_chs
        单独切给作业系统使用的记忆体大小， 0表示不切割。

config OPENRTOS_USE_TRACE_FACILITY
    bool "Use Trace Facility"
    default n
    help
        Use Trace Facility.
    help_cht
        開啟Trace Facility功能。
    help_chs
        开启Trace Facility功能。

config OPENRTOS_GENERATE_RUN_TIME_STATS
    bool "Generate Run Time statistics"
    default n
    help
        Generate Run Time statistics.
    help_cht
        開啟Generate Run Time statistics功能。
    help_chs
        开启Generate Run Time statistics功能。

config OPENRTOS_CLI
    bool "Command Line Interface"
    depends on (DBG_UART0 || DBG_UART1 || DBG_NETCONSOLE || USBD_ACM)
    default n
    help
        Command Line Interface.
    help_cht
        開啟命令列功能。
    help_chs
        开启命令行功能。

endmenu
```

## project/auo_demo/Kconfig
```kconfig
#
# For a description of the syntax of this configuration file,
# see Documentation/kbuild/kconfig-language.txt.
#

mainmenu "Project Configuration"

config CTRLBOARD
    bool
    default y
    select HAVE_LCD
    select HAVE_GRAPHICS
    select HAVE_AUDIO
    select HAVE_VIDEO

config CMAKE_SOURCE_DIR
    string
    option env="CMAKE_SOURCE_DIR"

config DEF_CHIP_PKG_IT9860
    def_bool y

config RAM_SIZE
    default "0x4000000"

config RAM_INIT_SCRIPT
    default "IT9860_360Mhz_DDR2_360Mhz.scr"

config TILING_WIDTH_128
    int
    default 0

config WATCHDOG_ENABLE
    def_bool y

config DCPS_ENABLE
    def_bool y

config FONT_FILENAME
    default "wqyMicroHeiProportional.ttf"

config BACKLIGHT_ENABLE
    def_bool y

config BACKLIGHT_DUTY_CYCLES
    default "95, 92, 88, 82, 75, 65, 55, 40, 25, 5"

config BACKLIGHT_DEFAULT_DUTY_CYCLE
    default "5"

config LCD_ENABLE
    def_bool y

if !LCD_MULTIPLE

config ENABLE_ROTATE
	def_bool y

config LCD_WIDTH
    default "1280"

config LCD_HEIGHT
    default "480"

config LCD_PITCH
    default "2560"

config LCD_INIT_SCRIPT
    default "IT9860_MIPI_TL068HWXH08_EK79030_480x1280_4LANE_byteclk53.txt"

endif

config CMDQ_ENABLE
    def_bool y

config M2D_ENABLE
    def_bool y

config JPEG_HW_ENABLE
    def_bool y

config AUDIO_ENABLE
    def_bool y

config AUDIO_DAC_MODULE
    default "itp_dac_ite970.c"

config AUDIO_CODEC_MP3DEC
    def_bool y

config AUDIO_CODEC_WMADEC
    def_bool y

config AUDIO_CODEC_WAV
    def_bool y

config COMPRESS_AUDIO_PLUGIN
    def_bool y

config VIDEO_ENABLE
    def_bool y

config NOR_ENABLE
    def_bool y

config NOR_USE_AXISPI
    def_bool y

config NOR_ENABLE_QUADMODE
    def_bool y

if NOR_ENABLE

config NOR_CACHE_SIZE
    default "0x200000"

config NOR_RESERVED_SIZE
    default "0x250000"

config NOR_PARTITION0
    def_bool y

config NOR_PARTITION0_SIZE
    default "0xAF0000"

config NOR_PARTITION1
    def_bool y

config NOR_PARTITION1_SIZE
    default "0x260000"

config NOR_PARTITION2
    def_bool y

config NOR_PARTITION2_SIZE
    default "0x40000"

config NOR_PARTITION3
    def_bool y

endif

config SD0_ENABLE
    def_bool n

config GPIO_SD0_CARD_DETECT
    default "22"

config GPIO_SD0_IO
    default "14, 13, 15, 16, 17, 18, -1, -1, -1, -1"

####SDIO WIFI CONFIG####
if SD1_ENABLE && NET_WIFI_SDIO
config GPIO_SD1_IO
      default "16, 17, 7, 15, 9, 10, -1, -1, -1, -1"

config SDIO_ENABLE
      def_bool y

config SDIO1_STATIC
    def_bool y
endif

if NET_WIFI_8188EUS
config NET_WIFI_REDEFINE
    def_bool y
endif

if NET_WIFI_SDIO_NGPL
config NET_WIFI_REDEFINE
    def_bool n
endif
########################

config USB0_ENABLE
    def_bool y

config MSC_ENABLE
    def_bool y

config FS_FAT
    def_bool y

config RTC_ENABLE
    def_bool y

config SPI_ENABLE
    def_bool n

config I2C1_ENABLE
    def_bool y

config GPIO_IIC1_CLK
    default "47"

config GPIO_IIC1_DATA
    default "46"

config TOUCH_ENABLE
    def_bool y

config TOUCH_MODULE
    default "gt911"

config TOUCH_X_MAX_VALUE
    default "0x4FF"

config TOUCH_Y_MAX_VALUE
    default "0x1DF"

config TOUCH_ADVANCE_CONFIG
	def_bool y

config TOUCH_REVERSE_X
	def_bool y

config GPIO_TOUCH_INT
    default "44"

config GPIO_TOUCH_RESET
    default "45"

config GPIO_TOUCH_WAKE
    default "-1"

config DEF_TOUCH_I2C1
    def_bool y

config TOUCH_INTR
    def_bool y

config AMPLIFIER_ENABLE
    def_bool y

config GPIO_AMPLIFIER_ENABLE
	default "23"

config GPIO_AMPLIFIER_MUTE
	default "23"

config I2S_ENABLE
    def_bool y

config I2S_SPDIF_ENABLE
    def_bool n

config POWER_SAVING_ENABLE
    def_bool y

config DEF_POWER_STANDBY
    def_bool y

config POWER_STANDBY_CPU_FREQ_RATIO
    default "15"

config POWER_STANDBY_BUS_FREQ_RATIO
    default "30"

config UART0_ENABLE
    def_bool y

config GPIO_UART0_TX
    default "4"

config GPIO_UART0_RX
    default "-1"

config AXISPI_ENABLE
    def_bool y

config AXISPI_MOSI_GPIO
    default "6"

config AXISPI_MISO_GPIO
    default "7"

config AXISPI_CLOCK_GPIO
    default "10"

config AXISPI_CHIP_SEL_GPIO
    default "5"

config AXISPI_WP_GPIO
    default "8"

config AXISPI_HOLD_GPIO
    default "9"

config GPIO_BACKLIGHT_PWM
    default "49"

config NET_ENABLE
    def_bool n

config TASK_DRIVE_PROBE
    def_bool y

config DEF_DBG_UART0
    def_bool y

config CANBUS_ENABLE
    def_bool y
    
config DBG_INIT_SCRIPT
    default "IT9860_360Mhz_DDR2_360Mhz.txt"

config DBG_STATS
    def_bool y

config DBG_STATS_HEAP
    def_bool y

config DEF_BUILD_MINSIZEREL
    def_bool y

config SYSTEM_NAME
    default "ITE Display Control Board"

config ITU_FT_CACHE_ENABLE
    def_bool y

config ITU_FT_CACHE_SIZE
    default "0xFA000"

config GCC_LTO
    def_bool y

config BUILD_AUDIO_MGR
    def_bool y

config BUILD_INIPARSER
    def_bool y

config BUILD_ITU
    def_bool y

config BUILD_SDL
    def_bool y

config BUILD_UPGRADE
    def_bool y

config BUILD_PYINPUT
    def_bool y

if NET_ENABLE

config NET_ETHERNET
    def_bool n

config NET_ETHERNET_LINK_INTR
    def_bool y

config NET_ETHERNET_MAC_ADDR_RANDOM
    def_bool y

if NET_ETHERNET
config NET_ETHERNET_MAC_ADDR_STORAGE
    def_bool y
endif

if NET_ETHERNET_MAC_ADDR_STORAGE

config NET_ETHERNET_MAC_ADDR_POS
    default "0x70000"

config NET_ETHERNET_MAC_ADDR_UPGRADE
    def_bool y

endif

config NET_DHCP_SERVER
    def_bool y

config DHCPS_ADDR_COUNT
    default "254"

config PING
    def_bool y

config BUILD_MICROHTTPD
    def_bool y

config BUILD_XML2
    def_bool y

config NET_HTTP
    def_bool y
endif

######################################################################
# Start of bootloader setting
######################################################################
config BOOTLOADER_ENABLE
    def_bool n

if BOOTLOADER_ENABLE && LCD_ENABLE && !LCD_MULTIPLE

config LCD_BOOT_BITMAP
    default "logo.bmp"

config BL_SHOW_LOGO
    def_bool y

endif

if BOOTLOADER_ENABLE

config UPGRADE_BOOTLOADER
    def_bool y

config UPGRADE_IMAGE
    def_bool y

config UPGRADE_DATA
    def_bool y

if UPGRADE_DATA
config UPGRADE_PRIVATE
    def_bool y

config UPGRADE_PUBLIC
    def_bool y

config UPGRADE_TEMP
    def_bool y
endif

config UPGRADE_OPEN_FILE
    def_bool y

config UPGRADE_PARTITION
    def_bool y

config UPGRADE_DELETE_PKGFILE_AFTER_FINISH
    def_bool y

if NOR_ENABLE
config DEF_UPGRADE_BOOTLOADER_NOR
    def_bool y

config DEF_UPGRADE_IMAGE_NOR
    def_bool y

config UPGRADE_IMAGE_POS
    default "0x80000"

config DEF_UPGRADE_PRIVATE_NOR
    def_bool y

config DEF_UPGRADE_PUBLIC_NOR
    def_bool y

config DEF_UPGRADE_TEMP_NOR
    def_bool y

config UPGRADE_NOR_IMAGE
    def_bool y

config UPGRADE_NOR_IMAGE_SIZE
    default "0x1000000"
endif

config BL_LCD_CONSOLE
    def_bool y

config BL_ERR
    def_bool y

config BL_WARN
    def_bool y

config BL_INFO
    def_bool y

config BL_DBG
    def_bool y

config CHECK_FILES_CRC_ON_BOOTING
    def_bool y

endif

######################################################################
# End of bootloader setting
######################################################################

source "$CMAKE_SOURCE_DIR/sdk/Kconfig"

######################################################################
# Project Menu
######################################################################
menu "Display Control Board"

    config CHECK_FILES_CRC_ON_BOOTING
        bool "Checking files' CRC on booting time"
        default n
        help
            Checking files' CRC on booting time
        help_cht
            開啟開機時檢查檔案 CRC 值的功能。
        help_chs
            开启开机时检查档案 CRC 值的功能。

    config HW_VERSION
        string "Hardware version"
        default "V01"
        help
            Hardware version
        help_cht
            硬體版號。
        help_chs
            硬件版号。

    config SCREENSHOT_ENABLE
        bool "Screenshot is enabled or not"
        default n
        help
            Screenshot is enabled or not
        help_cht
            開啟螢幕擷取功能。
        help_chs
            开启屏幕撷取功能。

    config WEBSERVER_PORT
        string "Web server port"
        default "80"
        help
            Web server port
        help_cht
            網頁伺服器埠號。
        help_chs
            网页服务器埠号。

    config ITU_PATH
        string "ITU files path"
        depends on !LCD_MULTIPLE
        default "itu/1280x480"
        help
            ITU files path
        help_cht
            ITU檔案路徑。
        help_chs
            ITU档案路径。

    config UPGRADE_FTP_URL
        string "Upgrade ftp URL"
        default "ftp://192.168.1.1/ctrlboard/ITEPKG03.PKG"
        help
            Upgrade ftp URL
        help_cht
            網路更新F/W路徑。
        help_chs
            网络更新F/W路径。

    config UPGRADE_GUI
        bool "Upgrade by graphics display"
        depends on !LCD_MULTIPLE
        default n
        help
            Upgrade by graphics display
        help_cht
            圖形顯示更新。
        help_chs
            图形显示更新。

    config UPGRADE_FROM_NAND
        bool "Upgrade from NAND disk"
        depends on NET_ENABLE && NAND_ENABLE
        default n
        help
            Upgrade from NAND disk
        help_cht
            從NAND磁碟機讀取升級檔案升級。
        help_chs
            从NAND磁碟机读取升级档案升级。

    config UPGRADE_NAND_DRIVE
        string "The drive of NAND disk"
        depends on UPGRADE_FROM_NAND
        default "D"
        help
            The drive of NAND disk
        help_cht
            NAND磁碟機名稱。
        help_chs
            NAND磁碟机名称。

    config DYNAMIC_LOAD_TP_MODULE
        bool "Dynamically Load the Touch Panel Module"
        default n
        help
            One PKG can support multiple TP module by modifying the Peripheral->TOUCH_MODULE.
        help_cht
            一個PKG可同時支援多組觸控模組，須配合Peripheral->TOUCH_MODULE的設定。
        help_chs
            一个PKG可同时支持多组触控模块，须配合Peripheral->TOUCH_MODULE的设定。

endmenu
```

## project/bootloader/Kconfig
```kconfig
#
# For a description of the syntax of this configuration file,
# see Documentation/kbuild/kconfig-language.txt.
#

mainmenu "Project Configuration"

config BOOTLOADER
    bool
    default y
    select HAVE_LCD
    select HAVE_GRAPHICS
    select HAVE_AUDIO
    #select HAVE_VIDEO

config CMAKE_SOURCE_DIR
	string
	option env="CMAKE_SOURCE_DIR"

config DEF_CHIP_PKG_IT9860
    def_bool y

config RAM_INIT_SCRIPT
    default "IT9860_360Mhz_DDR2_360Mhz.scr"

config DCPS_ENABLE
	def_bool y

config BACKLIGHT_DUTY_CYCLES
    default "95, 92, 88, 82, 75, 65, 55, 40, 25, 5"

config BACKLIGHT_DEFAULT_DUTY_CYCLE
    default "5"

config LCD_HEIGHT
    default "600"

config LCD_INIT_SCRIPT
    default "DEMOIT9860_MIPI_JY_1024x600_24bits.txt"

config NOR_CACHE_FLUSH_INTERVAL
	default "0"

config NOR_ENABLE
    def_bool y

config NOR_USE_AXISPI
    def_bool y

config NOR_ENABLE_QUADMODE
    def_bool y

config NOR_CACHE_SIZE
    default "0x80000"

config SD0_ENABLE
	def_bool y

config USB0_ENABLE
    def_bool y

config MSC_ENABLE
    def_bool y

config FS_FAT
	def_bool y

config I2C0_ENABLE
    default y

config UART1_ENABLE
	def_bool y

config KEYPAD_ENABLE
    def_bool y

config KEYPAD_MODULE
    default "itp_keypad_castor3.c"

config KEYPAD_REPEAT
    def_bool y

config GPIO_UART1_TX
    default "5"

config GPIO_UART1_RX
    default "-1"

config GPIO_KEYPAD
    default "42, 43"

config TOUCH_KEY_USE_I2C
    def_bool y
    
config GPIO_ETHERNET_LINK
    default "44"

config GPIO_ETHERNET
    default "27, 28, 29, 30, 31, 32, 33, 34, 35, 36"

config TASK_DRIVE_PROBE
    def_bool y

config UPGRADE_IMAGE
    def_bool y

config UPGRADE_OPEN_FILE
    def_bool y

config DEF_DBG_UART1
    def_bool y

config DBG_INIT_SCRIPT
    default "IT9860_360Mhz_DDR2_360Mhz.txt"

config BUILD_UPGRADE
	def_bool y

source "$CMAKE_SOURCE_DIR/sdk/Kconfig"

menu "BootLoader"

config BL_ERR
	bool "Error Log"
	default y
	help
		Output error log

config BL_WARN
	bool "Warning Log"
	default y
	help
		Output warning log

config BL_INFO
	bool "Information Log"
	default y
	help
		Output information log

config BL_DBG
	bool "Debug Log"
	default n
	help
		Output debug log

config BL_LCD_CONSOLE
	bool "Shows console to LCD"
	depends on LCD_ENABLE && !LCD_MULTIPLE
	default n
	help
		Shows console logs to LCD on upgrading mode.

endmenu
```
