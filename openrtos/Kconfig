## project/test_audio/Kconfig
```kconfig
#
# For a description of the syntax of this configuration file,
# see Documentation/kbuild/kconfig-language.txt.
#

mainmenu "Project Configuration"

config PROJECT_MODULE_DEFINED
    bool
    default y
    #select HAVE_LCD
    #select HAVE_GRAPHICS
    select HAVE_AUDIO
    #select HAVE_VIDEO

config DEF_CHIP_PKG_IT9860
    def_bool y

config RAM_INIT_SCRIPT
    default "IT9860_360Mhz_DDR2_360Mhz.scr"

config CMAKE_SOURCE_DIR
    string
    option env="CMAKE_SOURCE_DIR"

config I2S_ENABLE
    def_bool y

config AUDIO_ENABLE
    def_bool y

config AUDIO_DAC_MODULE
    default "itp_dac_ite970.c"

config UART1_ENABLE
    def_bool y

config GPIO_UART1_TX
    default "4"

config GPIO_UART1_RX
    default "-1"

config FS_FAT
	def_bool y
config USB0_ENABLE
    def_bool y

config MSC_ENABLE
    def_bool y

config TASK_DRIVE_PROBE
    def_bool y

config SPI_ENABLE
    def_bool y
    
config DEF_DBG_UART1
    def_bool y

config UART_INTR
    def_bool y
    
config BUILD_AUDIO_MGR
    def_bool y
    
config AUDIO_CODEC_MP3DEC
    def_bool y

config AUDIO_CODEC_WMADEC
    def_bool y

config AUDIO_CODEC_WAV
    def_bool y
    
config	AMPLIFIER_ENABLE
    def_bool y

config AMPLIFIER_MODULE
    default "itp_amp_gpio.c"

config GPIO_AMPLIFIER_ENABLE
    default "25"

config GPIO_AMPLIFIER_MUTE
    default "25"

config DBG_INIT_SCRIPT
    default "IT9860_360Mhz_DDR2_360Mhz.txt"

menu "TEST AUDIO"

    choice
    prompt "Select Test Item"
    default TEST_AUDIO_HW_CTRL
    help
        select test item.
    help_cht
        選擇測試項目
    help_chs
        選擇測試項目

    config TEST_AUDIO_HW_CTRL
    bool "test audio HW control"
    help
        test audio HW control (IIS DAC layout...)
    help_cht
        測試audio硬體 (IIS DAC 線路...)
    help_chs
        測試audio硬體 (IIS DAC 線路...)

    config TEST_AUDIO_MGR
    bool "test audio MGR "
    help
        test audio MGR API
    help_cht
        測試audio MGR API
    help_chs
        測試audio MGR API
        
    endchoice

    choice
    depends on TEST_AUDIO_HW_CTRL
    prompt "test audio HW ctrl"
    default SIMPLE_IIS_TEST_play
    help
        test audio HW ctrl.
    help_cht
        測試聲音硬體控制
    help_chs
        測試聲音硬體控制
    

    config USB_WAV_FILE_TEST
    bool "usb disk wav file play test"
    help
        usb disk wav file play test.
    help_cht
        usb disk wav檔測試撥放。
    help_chs
        usb disk wav檔測試撥放。

    config SIMPLE_IIS_TEST_play
    bool "simple iis play sound test"
    help
        simple iis test play sound.
    help_cht
        測試撥放聲音。
    help_chs
        測試撥放聲音。

    config USB_WAV_RECORD_FILE_TEST
    bool "usb disk wav record file test"
    help
        usb disk wav record file test.
    help_cht
        usb disk wav檔測試錄音。
    help_chs
        usb disk wav檔測試錄音。

    config AD_REC_DA_PLAY_TEST
    bool "AD record & DA play sound test"
    help
        TEST AD record & DA play sound.
    help_cht
        測試錄製並撥放聲音。
    help_chs
        測試錄製並撥放聲音。

    config AD_DA_LOUDER_TEST
    bool "louder test"
    help
        louder((AD & DA TEST)).
    help_cht
        擴音器(AD & DA 測試)。
    help_chs
        擴音器(AD & DA 測試)。
        
#    config FFT_SNR_TEST
#    bool "ffr snr record test"
#    help
#        1K tone out record test(output feedback to input) FFT meansure SNR.
#    help_cht
#        1K 頻率錄音(輸出回灌到輸入) FFT 測量 SNR。
#    help_chs
#        1K 頻率錄音(輸出回灌到輸入) FFT 測量 SNR。
        
#    config BIST_OUT_RECORD_TEST
#    bool "bist out record test"
#    help
#        1K tone out record test(output feedback to input).
#    help_cht
#        1K 頻率錄音(輸出回灌到輸入)。
#    help_chs
#        1K 頻率錄音(輸出回灌到輸入)。

    endchoice
    
    choice
    depends on TEST_AUDIO_MGR
    prompt "test audio MGR API"
    default AUDIOMGR_PLAY_TEST
    help
        test audio MGR API.
    help_cht
        測試audio mgr API
    help_chs
        測試audio mgr API
        
    config AUDIOMGR_PLAY_TEST
    bool "usb disk audiomgr test"
    help
        usb disk audiomgr test(audio codec:mp3 wma wav).
    help_cht
        usb disk audiomgr 測試(audio codec:mp3 wma wav)。
    help_chs
        usb disk audiomgr 測試(audio codec:mp3 wma wav)。
        
    config MP3_CODEC_TEST
    bool "mp3 codec decoder test"
    help
        mp3 codec decoder test.
    help_cht
        測試 mp3 codec 解碼。
    help_chs
        測試 mp3 codec 解碼。
        
        
    endchoice

endmenu

source "$CMAKE_SOURCE_DIR/sdk/Kconfig"
```

## project/test_audio/Kconfig.win32
```kconfig
#
# For a description of the syntax of this configuration file,
# see Documentation/kbuild/kconfig-language.txt.
#

mainmenu "Project Configuration"

config PROJECT_MODULE_DEFINED
    bool
    default y
    select HAVE_LCD
    select HAVE_GRAPHICS
    select HAVE_AUDIO
    select HAVE_VIDEO

config DEF_CHIP_PKG_IT9856
    def_bool y

config RAM_INIT_SCRIPT
    default "IT9850A0_400MHz.scr"

config DBG_INIT_SCRIPT
    default "IT9850A0_400MHz.txt"

config CMAKE_SOURCE_DIR
    string
    option env="CMAKE_SOURCE_DIR"

config I2S_ENABLE
    def_bool y

config AUDIO_ENABLE
    def_bool y

config AUDIO_DAC_MODULE
    default "itp_dac_alc5616.c"

config I2C0_ENABLE
    def_bool y

config DEF_I2S_USE_GPIO_MODE_2
    def_bool y

config BUILD_LINPHONE
    def_bool y

menu "TEST IIS"

    choice
    prompt "IIS TEST"
    default USB_WAV_FILE_TEST
    help
        Test IIS play wav sound.
    help_cht
        代刚 I2s 挤羘
    help_chs
        代刚 I2s 挤羘


    config USB_WAV_FILE_TEST
    bool "usb wav file play test"
    help
        usb wav file play test.
    help_cht
        usb wav郎代刚挤
    help_chs
        usb wav郎代刚挤

    config SIMPLE_IIS_TEST_play
    bool "simple iis play sound test"
    help
        simple iis test play sound.
    help_cht
        代刚iis挤羘
    help_chs
        代刚iis挤羘

    config USB_WAV_RECORD_FILE_TEST
    bool "usb wav record file test"
    help
        usb wav record file test.
    help_cht
        usb wav郎代刚魁
    help_chs
        usb wav郎代刚魁

    config AD_REC_DA_PLAY_TEST
    bool "AD record & DA play sound test"
    help
        TEST AD record & DA play sound.
    help_cht
        代刚魁籹挤羘
    help_chs
        代刚魁籹挤羘

    config DUAL_WAV_PLAY_TEST
    bool "dual wav mix test"
    help
        TEST dual wav mix.
    help_cht
        代刚蛮wav郎睼
    help_chs
        代刚蛮wav郎睼

    config AD_DA_LOUDER_TEST
    bool "louder test"
    help
        louder((AD & DA TEST)).
    help_cht
        耎竟(AD & DA 代刚)
    help_chs
        耎竟(AD & DA 代刚)

    config 970_SIMPLE_IIS_TEST_play
    bool "simple iis play sound test for 970"
    depends on CHIP_PKG_IT970
    help
        simple iis test play sound for 970.
    help_cht
        代刚iis挤羘(970 use)
    help_chs
        代刚iis挤羘(970 use)

    config 9920_LOOPBACK_TEST
    bool "iis loopback test for 970"
    depends on CHIP_PKG_IT970
    help
        iis loopback test for 970.
    help_cht
        代刚iis loopback挤羘(970 use)
    help_chs
        代刚iis loopback挤羘(970 use)

    endchoice

endmenu

source "$CMAKE_SOURCE_DIR/sdk/Kconfig"
```

## project/test_canbus/Kconfig
```kconfig
#
# For a description of the syntax of this configuration file,
# see Documentation/kbuild/kconfig-language.txt.
#

mainmenu "Project Configuration"

config TEST_UART
    bool
    default y
    #select HAVE_LCD
    #select HAVE_GRAPHICS
    #select HAVE_AUDIO
    #select HAVE_VIDEO

config DEF_CHIP_PKG_IT9860
    def_bool y

config RAM_INIT_SCRIPT
    default "IT9860_360Mhz_DDR2_360Mhz.scr"

config CMAKE_SOURCE_DIR
    string
    option env="CMAKE_SOURCE_DIR"

config FS_FAT
    def_bool n

config UART1_ENABLE
    def_bool y

config GPIO_UART1_TX
    default "4"

config GPIO_UART1_RX
    default "-1"

config NOR_ENABLE
    def_bool n

config SPI0_ENABLE
    def_bool n

config SPI0_MISO_GPIO
    default "58"

config SPI0_MOSI_GPIO
    default "57"

config SPI0_CLOCK_GPIO
    default "55"

config SPI0_CHIP_SEL_GPIO
    default "56"

config DEF_DBG_UART1
    def_bool y

config CANBUS_ENABLE
    def_bool y


config DBG_INIT_SCRIPT
    default "IT9860_360Mhz_DDR2_360Mhz.txt"

source "$CMAKE_SOURCE_DIR/sdk/Kconfig"
```

## project/test_canbus/Kconfig.win32
```kconfig
#
# For a description of the syntax of this configuration file,
# see Documentation/kbuild/kconfig-language.txt.
#

mainmenu "Project Configuration"

config CMAKE_SOURCE_DIR
    string
    option env="CMAKE_SOURCE_DIR"

config TEST_CANBUS
    bool
    default y

config DEF_CHIP_PKG_IT9860
    def_bool y

config CANBUS_ENABLE
    def_bool y

config RAM_SIZE
    default "0x4000000"

config RAM_INIT_SCRIPT
    default "IT9860_360Mhz_DDR2_360Mhz.scr"

config DBG_INIT_SCRIPT
    default "IT9860_360Mhz_DDR2_360Mhz.txt"

config UART1_ENABLE
    def_bool y

config GPIO_UART1_TX
    default "4"

config GPIO_UART1_RX
    default "-1"

config WATCHDOG_ENABLE
    def_bool n

config RTC_ENABLE
    def_bool n

source "$CMAKE_SOURCE_DIR/sdk/Kconfig"
```

## project/test_cap/Kconfig
```kconfig
#
# For a description of the syntax of this configuration file,
# see Documentation/kbuild/kconfig-language.txt.
#

mainmenu "Project Configuration"

config TEST_CAP
    bool
    default y
    select HAVE_LCD
    select HAVE_GRAPHICS
    select HAVE_VIDEO
    select HAVE_AUDIO

config CMAKE_SOURCE_DIR
    string
    option env="CMAKE_SOURCE_DIR"

config DEF_CHIP_PKG_IT9860
    def_bool y

config DEF_CPU_FA626
    def_bool y

config RAM_SIZE
    default "0x4000000"

config RAM_INIT_SCRIPT
    default "IT9860_264Mhz_DDR2_264Mhz.scr"

config LCD_ENABLE
    def_bool n

config BACKLIGHT_ENABLE
    def_bool n

config DBG_INIT_SCRIPT
    default "IT9860_264Mhz_DDR2_264Mhz.txt"

config I2C0_ENABLE
    def_bool y

config GPIO_IIC0_CLK
    default "37"

config GPIO_IIC0_DATA
    default "39"

config UART0_ENABLE
    def_bool n

config UART1_ENABLE
    def_bool y

config GPIO_UART1_TX
    default "4"

config GPIO_UART1_RX
    default "-1"

config CAPTURE_DEFINE
    default "DEMO_9860_DEFAULT.txt"

config SENSOR_ENABLE
    def_bool y

config VIDEO_ENABLE
    def_bool y

config STC_ENABLE
    def_bool y

config FS_FAT
    def_bool y

config ITU_UCL_ENABLE
    def_bool n

config BUILD_INIPARSER
    def_bool n

config BUILD_ITU
    def_bool n

config BUILD_SDL
    def_bool n

config TASK_DRIVE_PROBE
    def_bool n

config RECORD_VIDEO
    def_bool n

config AUDIO_DAC_MODULE
    default "itp_dac_ite970.c"

config AUDIO_CODEC_MP3DEC
    def_bool y

config AUDIO_CODEC_WAV
    def_bool y

config AUDIO_CODEC_WMADEC
    def_bool y

config COMPRESS_AUDIO_PLUGIN
    def_bool y

config BUILD_AUDIO_MGR
    def_bool y

source "$CMAKE_SOURCE_DIR/sdk/Kconfig"


menu "CAP TEST FUNCTION"

    choice
        prompt "Test CAP"
        default CAP_MODULE_MODE

    config CAP_MODULE_MODE
        bool "CAP_MODULE_MODE"
        help
            Peripheral->SENSOR_ENABLE = true
    endchoice

endmenu
```

## project/test_cap/Kconfig.win32
```kconfig
#
# For a description of the syntax of this configuration file,
# see Documentation/kbuild/kconfig-language.txt.
#

mainmenu "Project Configuration"


config TEST_VIDEO
    bool
    default y
    select HAVE_LCD
    select HAVE_GRAPHICS
    select HAVE_VIDEO

config LCD_ENABLE
    def_bool y

config VIDEO_ENABLE
    def_bool y

config CMAKE_SOURCE_DIR
    string
    option env="CMAKE_SOURCE_DIR"

config DEF_CHIP_PKG_IT976
    def_bool y

config DEF_CPU_FA626
    def_bool y

config LCD_ENABLE
    def_bool y

config LCD_WIDTH
    default "1024"

config LCD_HEIGHT
    default "600"

config LCD_PITCH
    default "2048"

config LCD_INIT_SCRIPT
    default "DEMOIT9860_MIPI_JY_1024x600_24bits.txt"

source "$CMAKE_SOURCE_DIR/sdk/Kconfig"
```

## project/test_cli/Kconfig
```kconfig
#
# For a description of the syntax of this configuration file,
# see Documentation/kbuild/kconfig-language.txt.
#

mainmenu "Project Configuration"

config CMAKE_SOURCE_DIR
    string
    option env="CMAKE_SOURCE_DIR"

config OPENRTOS_USE_TRACE_FACILITY
    def_bool y

config OPENRTOS_GENERATE_RUN_TIME_STATS
    def_bool y

config OPENRTOS_CLI
    def_bool y

config NOR_ENABLE
    def_bool y

config NOR_CACHE_SIZE
    default "0x200000"

config NOR_RESERVED_SIZE
    default "0x2D0000"

config NOR_PARTITION0
    def_bool y

config NOR_PARTITION0_SIZE
    default "0xDC0000"

config NOR_PARTITION1
    def_bool y

config NOR_PARTITION1_SIZE
    default "0x40000"

config NOR_PARTITION2
    def_bool y

config NOR_PARTITION2_SIZE
    default "0xF0000"

config NOR_PARTITION3
    def_bool y

config NOR_USE_AXISPI
    def_bool y
    
config NOR_ENABLE_QUADMODE
    def_bool y
        
config FS_FAT
    def_bool y

config AXISPI_ENABLE
    def_bool y

config UART1_ENABLE
    def_bool y

config USB0_ENABLE
    def_bool y

config USB_DEVICE
    def_bool y

config DEF_USB_DEVICE_USB0
    def_bool y

config USBD_ACM
    def_bool y

config USB_VENDOR_ID
    default "0x1D6B"

config USB_PRODUCT_ID
    default "0x0106"

config GPIO_USB_ID_PIN
    default "17"

config GPIO_UART1_TX
    default "4"

config GPIO_UART1_RX
    default "14"

config AXISPI_MOSI_GPIO
    default "7"

config AXISPI_MISO_GPIO
    default "8"

config AXISPI_CLOCK_GPIO
    default "5"

config AXISPI_CHIP_SEL_GPIO
    default "6"

config AXISPI_WP_GPIO
    default "9"

config AXISPI_HOLD_GPIO
    default "10"

config TASK_DRIVE_PROBE
    def_bool y

config UPGRADE_IMAGE
	def_bool y

config BUILD_CLI
	def_bool y

config BUILD_UPGRADE
	def_bool y

source "$CMAKE_SOURCE_DIR/sdk/Kconfig"
```

## project/test_ecm/Kconfig.N720
```kconfig
#
# For a description of the syntax of this configuration file,
# see Documentation/kbuild/kconfig-language.txt.
#

mainmenu "Project Configuration"

config CMAKE_SOURCE_DIR
    string
    option env="CMAKE_SOURCE_DIR"

config DEF_CHIP_PKG_IT9860
    def_bool y

config ROM_COMPRESS
    def_bool n
    
config UART1_ENABLE
    def_bool y

config GPIO_UART1_TX
    default "4"

config GPIO_UART1_RX
    default "-1"

config USB0_ENABLE
    def_bool y

#==== for NET ====
config NET_ENABLE
    def_bool y

config NET_ETHERNET
    def_bool n

config NET_ETHERNET_4G
    def_bool y

config DEF_NET_N720_4G
    def_bool y

config USB_ECM
    def_bool y

config USB_SERIAL
    def_bool y
		
config USB_OPTION
    def_bool y

config NET_HTTP
    def_bool y
    
config PING
	def_bool y

config DBG_INIT_SCRIPT
    default "IT9860_360Mhz_DDR2_360Mhz.txt"



source "$CMAKE_SOURCE_DIR/sdk/Kconfig"


menu "ECM Network Test"

choice
    prompt "Test App"
    default TEST_HTTP

config TEST_PING
    bool "Ping Test"
    help
        Test with Ping.

config PING_IP
    string "IP"
    depends on TEST_PING
    default "172.217.160.78"
    help
        google: 172.217.160.78

config TEST_HTTP
    bool "Http Download Test"
    help
        Test with http download.

config HTTP_URL
    string "URL"
    depends on TEST_HTTP
    default "http://soc.ite.com.tw/index.php/applications/appliance/file/General%20Hardware%20Platform%20Introduction%252EMOV"
    help
        Set URL for http downlad.

endchoice

endmenu
```

## project/test_ecm/Kconfig.N720.option
```kconfig
#
# For a description of the syntax of this configuration file,
# see Documentation/kbuild/kconfig-language.txt.
#

mainmenu "Project Configuration"

config CMAKE_SOURCE_DIR
    string
    option env="CMAKE_SOURCE_DIR"


config ROM_COMPRESS
    def_bool n
    
config UART1_ENABLE
    def_bool y

config GPIO_UART1_TX
    default "4"

config GPIO_UART1_RX
    default "-1"

config USB0_ENABLE
    def_bool y

config USB_SERIAL
    def_bool y
		
config USB_OPTION
    def_bool y



source "$CMAKE_SOURCE_DIR/sdk/Kconfig"


menu "Test"

endmenu
```
