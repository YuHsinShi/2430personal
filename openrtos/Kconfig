## project/test_itu/Kconfig
```kconfig
#
# For a description of the syntax of this configuration file,
# see Documentation/kbuild/kconfig-language.txt.
#

mainmenu "Project Configuration"

config TEST_ITU
    bool
    default y
    select HAVE_LCD
    select HAVE_GRAPHICS
    select HAVE_AUDIO
    select HAVE_VIDEO

config CMAKE_SOURCE_DIR
    string
    option env="CMAKE_SOURCE_DIR"

config DEF_CHIP_PKG_IT9860
    def_bool y

config RAM_SIZE
    default "0x4000000"

config RAM_INIT_SCRIPT
    default "IT9860_360Mhz_DDR2_360Mhz.scr"

config TILING_WIDTH_128
    int
    default 0

config WATCHDOG_ENABLE
    def_bool y

config DCPS_ENABLE
    def_bool y

config FONT_FILENAME
    default "WenQuanYiMicroHeiMono.ttf"

config BACKLIGHT_ENABLE
    def_bool y

config BACKLIGHT_DUTY_CYCLES
    default "95, 92, 88, 82, 75, 65, 55, 40, 25, 5"

config BACKLIGHT_DEFAULT_DUTY_CYCLE
    default "5"

config LCD_ENABLE
    def_bool y

config LCD_WIDTH
    default "1280"

config LCD_HEIGHT
    default "480"

config LCD_PITCH
    default "2560"

config LCD_INIT_SCRIPT
    default "IT9860_MIPI_TL068HWXH08_EK79030_480x1280_4LANE_byteclk53.txt"

config LCD_TRIPLE_BUFFER
    default n

config CMDQ_ENABLE
    def_bool y

config M2D_ENABLE
    def_bool y

config JPEG_HW_ENABLE
    def_bool y

config AUDIO_ENABLE
    def_bool y

config AUDIO_DAC_MODULE
    default "itp_dac_ite970.c"

config AUDIO_CODEC_MP3DEC
    def_bool y

config AUDIO_CODEC_WMADEC
    def_bool y

config AUDIO_CODEC_WAV
    def_bool y

config VIDEO_ENABLE
    def_bool y

config KEYPAD_ENABLE
config SD0_ENABLE
    def_bool y

config GPIO_SD0_CARD_DETECT
    default "22"

config GPIO_SD0_IO
    default "14, 13, 15, 16, 17, 18, -1, -1, -1, -1"

config USB0_ENABLE
    def_bool n

config MSC_ENABLE
    def_bool n

config FS_FAT
    def_bool y

config I2C1_ENABLE
    def_bool y

config GPIO_IIC1_CLK
    default "47"

config GPIO_IIC1_DATA
    default "46"

config TOUCH_ENABLE
    def_bool y

config TOUCH_MODULE
    default "gt911"

config TOUCH_X_MAX_VALUE
    default "0x4FF"

config TOUCH_Y_MAX_VALUE
    default "0x1DF"

config TOUCH_ADVANCE_CONFIG
	def_bool y

config TOUCH_REVERSE_X
	def_bool y

config GPIO_TOUCH_INT
    default "44"

config GPIO_TOUCH_RESET
    default "45"

config GPIO_TOUCH_WAKE
    default "-1"

config DEF_TOUCH_I2C1
    def_bool y

config TOUCH_INTR
    def_bool y

config I2S_ENABLE
    def_bool y

config I2S_SPDIF_ENABLE
    def_bool n

config GPIO_UART0_TX
    default "4"

config GPIO_UART0_RX
    default "-1"

config GPIO_BACKLIGHT_PWM
    default "49"

config TASK_DRIVE_PROBE
    def_bool y

config DBG_INIT_SCRIPT
    default "IT9860_360Mhz_DDR2_360Mhz.txt"
config ITU_FT_CACHE_ENABLE
    def_bool y

config ITU_FT_CACHE_SIZE
    default "0xFA000"

config BUILD_ITU
    def_bool y

config BUILD_AUDIO_MGR
    def_bool y

config BUILD_SDL
    def_bool y

source "$CMAKE_SOURCE_DIR/sdk/Kconfig"

menu "ITU Test"

choice
    prompt "Test App"
    default TEST_SDL

config TEST_SDL
    bool "SDL"

config TEST_STNLCD
    bool "STNLCD"

config TEST_HELLOWORLD
    bool "HELLOWORLD"

config TEST_BUTTON
    bool "BUTTON"

config TEST_LANGUAGE
    bool "LANGUAGE"

config TEST_CURSOR
    bool "CURSOR"

config TEST_PROGRESSBAR
    bool "PROGRESSBAR"

config TEST_LISTBOX
    bool "LISTBOX"

config TEST_TRACKBAR
    bool "TRACKBAR"

config TEST_ARRAY
    bool "ARRAY"

config TEST_JPEG
    bool "JPEG"

config TEST_MULTILINE
    bool "MULTILINE"

config TEST_COMPRESS
    bool "COMPRESS"

config TEST_FUNCTION
    bool "FUNCTION"

config TEST_LISTBOX2
    bool "LISTBOX2"

config TEST_CUSTOM
    bool "CUSTOM"

config TEST_ICONLISTBOX
    bool "ICONLISTBOX"

config TEST_CIRCLEPROGRESSBAR
    bool "CIRCLEPROGRESSBAR"

config TEST_DRAW
    bool "DRAW"

config TEST_SCROLLBAR
    bool "SCROLLBAR"

config TEST_WHEEL
    bool "WHEEL"

config TEST_COVERFLOW
    bool "COVERFLOW"

config TEST_SCROLLLISTBOX
    bool "SCROLLLISTBOX"

config TEST_METER
    bool "METER"

config TEST_VIDEO
    bool "VIDEO"

config TEST_COLORPICKER
    bool "COLORPICKER"

config TEST_IMAGECOVERFLOW
    bool "IMAGECOVERFLOW"

config TEST_CURVE
    bool "CURVE"

config TEST_TABLELISTBOX
    bool "TABLELISTBOX"

config TEST_PNG
    bool "PNG"

config TEST_TABLEICONLISTBOX
    bool "TABLEICONLISTBOX"

config TEST_MULTIFONT
    bool "MULTIFONT"

config TEST_CLONE
    bool "CLONE"

config TEST_TABLELISTBOX2
    bool "TABLELISTBOX2"

config TEST_ANIMPAGE
    bool "ANIMPAGE"

config TEST_BITBLT
    bool "BITBLT"

config TEST_FILESLIDESHOW
    bool "FILESLIDESHOW"

config TEST_SHOWLOGO
    bool "SHOWLOGO"

config TEST_MULTIGESTURE
    bool "MULTIGESTURE"

config TEST_CLIPPINGCOLOR
    bool "CLIPPINGCOLOR"

config TEST_ROTATE
    bool "ROTATE"

config TEST_COVERFLOW2
    bool "COVERFLOW2"

config TEST_WAVEBACKGROUND
    bool "WAVEBACKGROUND"

config TEST_OSCILLOSCOPE
    bool "OSCILLOSCOPE"

config TEST_CUSTOMWIDGET
    bool "CUSTOMWIDGET"

config TEST_TABLEGRID
	bool "TABLEGRID"

config TEST_MIRROR
	  bool "MIRROR"

endchoice

endmenu
```
