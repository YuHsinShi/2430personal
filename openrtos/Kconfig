## project/burner_portable/Kconfig
```kconfig
#
# For a description of the syntax of this configuration file,
# see Documentation/kbuild/kconfig-language.txt.
#

mainmenu "Project Configuration"


config CMAKE_SOURCE_DIR
    string
    option env="CMAKE_SOURCE_DIR"

config DEF_CHIP_PKG_IT9860
    def_bool y

config RAM_SIZE
    default "0x4000000"

config RAM_INIT_SCRIPT
    default "IT9860_360Mhz_DDR2_360Mhz.scr"

config TILING_WIDTH_128
    int
    default 0

config WATCHDOG_ENABLE
    def_bool y

config DCPS_ENABLE
    def_bool y



config NOR_ENABLE
    def_bool y

config NOR_USE_AXISPI
    def_bool y

config NOR_ENABLE_QUADMODE
    def_bool y

if NOR_ENABLE

config NOR_CACHE_SIZE
    default "0x200000"

config NOR_RESERVED_SIZE
    default "0x250000"

config NOR_PARTITION0
    def_bool y

config NOR_PARTITION0_SIZE
    default "0xAF0000"

config NOR_PARTITION1
    def_bool y

config NOR_PARTITION1_SIZE
    default "0x260000"

config NOR_PARTITION2
    def_bool y

config NOR_PARTITION2_SIZE
    default "0x40000"

config NOR_PARTITION3
    def_bool y

endif

config SD0_ENABLE
    def_bool n

config GPIO_SD0_CARD_DETECT
    default "22"

config GPIO_SD0_IO
    default "14, 13, 15, 16, 17, 18, -1, -1, -1, -1"


config USB0_ENABLE
    def_bool y

config MSC_ENABLE
    def_bool y

config FS_FAT
    def_bool y

config RTC_ENABLE
    def_bool y

config RTC_MODULE
    default "itp_rtc_sw.c"




config GPIO_UART0_TX
    default "4"

config GPIO_UART0_RX
    default "-1"

config AXISPI_ENABLE
    def_bool y

config AXISPI_MOSI_GPIO
    default "6"

config AXISPI_MISO_GPIO
    default "7"

config AXISPI_CLOCK_GPIO
    default "10"

config AXISPI_CHIP_SEL_GPIO
    default "5"

config AXISPI_WP_GPIO
    default "8"

config AXISPI_HOLD_GPIO
    default "9"

config TASK_DRIVE_PROBE
    def_bool y

config DBG_INIT_SCRIPT
    default "IT9860_360Mhz_DDR2_360Mhz.txt"

config DBG_STATS
    def_bool y

config DBG_STATS_HEAP
    def_bool y

config DEF_BUILD_MINSIZEREL
    def_bool y

config SYSTEM_NAME
    default "burner"


config GCC_LTO
    def_bool y

config BUILD_INIPARSER
    def_bool y


config BUILD_SDL
    def_bool y

config BUILD_UPGRADE
    def_bool y


config SPI_ENABLE
    def_bool n


######################################################################
# Start of bootloader setting
######################################################################
config BOOTLOADER_ENABLE
    def_bool n

if BOOTLOADER_ENABLE && LCD_ENABLE && !LCD_MULTIPLE

config LCD_BOOT_BITMAP
    default "logo.bmp"

config BL_SHOW_LOGO
    def_bool y

endif

if BOOTLOADER_ENABLE

config UPGRADE_BOOTLOADER
    def_bool y

config UPGRADE_IMAGE
    def_bool y

config UPGRADE_DATA
    def_bool y

if UPGRADE_DATA
config UPGRADE_PRIVATE
    def_bool y

config UPGRADE_PUBLIC
    def_bool y

config UPGRADE_TEMP
    def_bool y
endif

config UPGRADE_OPEN_FILE
    def_bool y

config UPGRADE_PARTITION
    def_bool y

config UPGRADE_DELETE_PKGFILE_AFTER_FINISH
    def_bool y

if NOR_ENABLE
config DEF_UPGRADE_BOOTLOADER_NOR
    def_bool y

config DEF_UPGRADE_IMAGE_NOR
    def_bool y

config UPGRADE_IMAGE_POS
    default "0x80000"

config DEF_UPGRADE_PRIVATE_NOR
    def_bool y

config DEF_UPGRADE_PUBLIC_NOR
    def_bool y

config DEF_UPGRADE_TEMP_NOR
    def_bool y

config UPGRADE_NOR_IMAGE
    def_bool y

config UPGRADE_NOR_IMAGE_SIZE
    default "0x1000000"
endif

config BL_LCD_CONSOLE
    def_bool y

config BL_ERR
    def_bool y

config BL_WARN
    def_bool y

config BL_INFO
    def_bool y

config BL_DBG
    def_bool y

config CHECK_FILES_CRC_ON_BOOTING
    def_bool y

endif

######################################################################
# End of bootloader setting
######################################################################

source "$CMAKE_SOURCE_DIR/sdk/Kconfig"

######################################################################
# Project Menu
######################################################################
menu "Display Control Board"

    config CHECK_FILES_CRC_ON_BOOTING
        bool "Checking files' CRC on booting time"
        default n
        help
            Checking files' CRC on booting time
        help_cht
            開啟開機時檢查檔案 CRC 值的功能。
        help_chs
            开启开机时检查档案 CRC 值的功能。

    config HW_VERSION
        string "Hardware version"
        default "V01"
        help
            Hardware version
        help_cht
            硬體版號。
        help_chs
            硬件版号。

    config SCREENSHOT_ENABLE
        bool "Screenshot is enabled or not"
        default n
        help
            Screenshot is enabled or not
        help_cht
            開啟螢幕擷取功能。
        help_chs
            开启屏幕撷取功能。

    config WEBSERVER_PORT
        string "Web server port"
        default "80"
        help
            Web server port
        help_cht
            網頁伺服器埠號。
        help_chs
            网页服务器埠号。

    config ITU_PATH
        string "ITU files path"
        depends on !LCD_MULTIPLE
        default "itu/1280x480"
        help
            ITU files path
        help_cht
            ITU檔案路徑。
        help_chs
            ITU档案路径。

    config UPGRADE_FTP_URL
        string "Upgrade ftp URL"
        default "ftp://192.168.1.1/ctrlboard/ITEPKG03.PKG"
        help
            Upgrade ftp URL
        help_cht
            網路更新F/W路徑。
        help_chs
            网络更新F/W路径。

    config UPGRADE_GUI
        bool "Upgrade by graphics display"
        depends on !LCD_MULTIPLE
        default n
        help
            Upgrade by graphics display
        help_cht
            圖形顯示更新。
        help_chs
            图形显示更新。

    config DYNAMIC_LOAD_TP_MODULE
        bool "Dynamically Load the Touch Panel Module"
        default n
        help
            One PKG can support multiple TP module by modifying the Peripheral->TOUCH_MODULE.
        help_cht
            一個PKG可同時支援多組觸控模組，須配合Peripheral->TOUCH_MODULE的設定。
        help_chs
            一个PKG可同时支持多组触控模块，须配合Peripheral->TOUCH_MODULE的设定。

endmenu
```

## project/dynamic_ui/Kconfig.win32
```kconfig
#
# For a description of the syntax of this configuration file,
# see Documentation/kbuild/kconfig-language.txt.
#

mainmenu "Project Configuration"

config DYNAMIC_UI
    bool
    default y
    select HAVE_LCD
    select HAVE_GRAPHICS
    select HAVE_AUDIO

config CMAKE_SOURCE_DIR
	string
	option env="CMAKE_SOURCE_DIR"

config RAM_SIZE
    default "0x800000"

config WATCHDOG_ENABLE
    def_bool y

config FONT_FILENAME
    default "DroidSansMono.ttf"

config LCD_ENABLE
    def_bool y

config LCD_WIDTH
    default "1024"

config LCD_HEIGHT
    default "600"

config LCD_PITCH
    default "2048"

config LCD_INIT_SCRIPT
    default "DEMOIT9860_MIPI_JY_1024x600_24bits.txt"

config AUDIO_ENABLE
    def_bool y

config I2S_ENABLE
    def_bool y

config DEF_BUILD_DEBUG
    def_bool y

config WIN32_SIMULATOR
    def_bool y

config ITU_UCL_ENABLE
    def_bool y

config BUILD_AUDIO_MGR
    def_bool y

config BUILD_INIPARSER
    def_bool y

config BUILD_ITU
    def_bool y

config BUILD_SDL
    def_bool y

source "$CMAKE_SOURCE_DIR/sdk/Kconfig"
```

## project/instrument_cluster/Kconfig.win32
```kconfig
#
# For a description of the syntax of this configuration file,
# see Documentation/kbuild/kconfig-language.txt.
#

mainmenu "Project Configuration"

config DASHBOARD
    bool
    default y
    select HAVE_LCD
    select HAVE_GRAPHICS
    select HAVE_AUDIO

config CMAKE_SOURCE_DIR
	string
	option env="CMAKE_SOURCE_DIR"

config RAM_SIZE
    default "0x4000000"

config RAM_INIT_SCRIPT
    default "IT9860_360Mhz_DDR2_360Mhz.scr"

config WATCHDOG_ENABLE
    def_bool y

config FONT_FILENAME
    default "Probert.ttf"

config BACKLIGHT_ENABLE
    def_bool y

config BACKLIGHT_DUTY_CYCLES
    default "95, 92, 88, 82, 75, 65, 55, 40, 25, 5"

config BACKLIGHT_DEFAULT_DUTY_CYCLE
    default "5"

config ENABLE_ROTATE
    def_bool n

config LCD_ENABLE
    def_bool y

if !LCD_MULTIPLE

config LCD_WIDTH
    default "1280"

config LCD_HEIGHT
    default "480"

config LCD_PITCH
    default "2560"

config LCD_INIT_SCRIPT
    default "LVDS_1280_480_VESA24bits_new.txt"

endif

config CMDQ_ENABLE
    def_bool y

config AUDIO_ENABLE
    def_bool y

config SD0_ENABLE
    def_bool y

config FS_FAT
    def_bool y

config I2C0_ENABLE
    def_bool y

config I2S_ENABLE
    def_bool y

config I2S_SPDIF_ENABLE
    def_bool n

config UART1_ENABLE
    def_bool y

config TOUCH_ENABLE
    def_bool y

config NET_ENABLE
    def_bool n

config DEF_DBG_UART1
    def_bool y

config DEF_BUILD_DEBUG
    def_bool y

config SYSTEM_NAME
    default "ITE Display Control Board"

config WIN32_SIMULATOR
    def_bool y

config FFMPEG_ENC
    def_bool y

config FFMPEG_H264_SW
    def_bool y

config ITU_FT_CACHE_ENABLE
    def_bool y

config ITU_UCL_ENABLE
    def_bool y

config BUILD_AUDIO_MGR
    def_bool y

config BUILD_INIPARSER
    def_bool y

config BUILD_ITU
    def_bool y

config BUILD_SDL
    def_bool y

config BUILD_UPGRADE
    def_bool y

config BUILD_PYINPUT
    def_bool y
    
#config BUILD_LEAF
#    def_bool y
    
#config BUILD_LINPHONE
#    def_bool y

if NET_ENABLE

config NET_ETHERNET
    def_bool y

config NET_HTTP
    def_bool y

config BUILD_MICROHTTPD
    def_bool y

config BUILD_XML2
    def_bool y

endif

source "$CMAKE_SOURCE_DIR/sdk/Kconfig"

######################################################################
# Project Menu
######################################################################
menu "Display Control Board"

    config CHECK_FILES_CRC_ON_BOOTING
        bool "Checking files' CRC on booting time"
        default n
        help
            Checking files' CRC on booting time
        help_cht
            ?å??æ??æª¢?¥æ?æ¡?CRC ?¼ç??è½??
        help_chs
            å¼?¯å??ºæ¶æ£?¥æ¡£æ¡?CRC ?¼ç??è½??

    config HW_VERSION
        string "Hardware version"
        default "V2"
        help
            Hardware version
        help_cht
            ç¡¬é??è???
        help_chs
            ç¡¬ä»¶?å·??

    config SCREENSHOT_ENABLE
        bool "Screenshot is enabled or not"
        default n
        help
            Screenshot is enabled or not
        help_cht
            ?å??¢å??·å??è½??
        help_chs
            å¼?¯å?å¹æ·?å??½ã?

    config WEBSERVER_PORT
        string "Web server port"
        default "80"
        help
            Web server port
        help_cht
            ç¶²é?ä¼ºæ??¨å??ã?
        help_chs
            ç½é¡µ?å¡?¨å??·ã?

    config ITU_PATH
        string "ITU files path"
        depends on !LCD_MULTIPLE
        default "itu/1280x480"
        help
            ITU files path
        help_cht
            ITUæªæ?è·¯å???
        help_chs
            ITUæ¡??è·¯å???

    config UPGRADE_FTP_URL
        string "Upgrade ftp URL"
        default "ftp://192.168.1.1/ctrlboard/ITEPKG03.PKG"
        help
            Upgrade ftp URL
        help_cht
            ç¶²è·¯?´æ°F/Wè·¯å???
        help_chs
            ç½ç??´æ°F/Wè·¯å???

    config UPGRADE_GUI
        bool "Upgrade by graphics display"
        depends on !LCD_MULTIPLE
        default n
        help
            Upgrade by graphics display
        help_cht
            ?å½¢é¡¯ç¤º?´æ°??
        help_chs
            ??PKG???????????,???Peripheral->TOUCH_MODULE????

    config AUTO_RUN
        bool "Auto Run Enable"
        default n
        help
            Auto Demo.
        help_cht
            ???????
        help_chs
            ???????

    config AUTO_CHANGE_TYPE
        bool "Auto Type Enable"
        default n
        help
            Auto Demo with Change Type.
        help_cht
            ?????????
        help_chs
            ?????????
            
endmenu
```
