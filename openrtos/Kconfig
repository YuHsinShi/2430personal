## project/test_esp32/Kconfig
```kconfig
#
# For a description of the syntax of this configuration file,
# see Documentation/kbuild/kconfig-language.txt.
#

mainmenu "Project Configuration"

config CMAKE_SOURCE_DIR
    string
    option env="CMAKE_SOURCE_DIR"

config DEF_CHIP_PKG_IT9860
    def_bool y

config ROM_COMPRESS
    def_bool n

config DEF_DBG_UART0
    def_bool y

config UART0_ENABLE
    def_bool y

config GPIO_UART0_TX
    default "4"

config GPIO_UART0_RX
    default "-1"
	
#==== for SD ====
config SD1_ENABLE
    def_bool y

config SDIO_ENABLE
    def_bool y

config SDIO1_STATIC
    def_bool y

config GPIO_SD1_IO
      default "11, 13, 15, 16, 17, 18, -1, -1, -1, -1"
    
config UART1_ENABLE
    def_bool y

config ESP32_SDIO_AT
	def_bool y
	
config SDIO_4BIT_MODE
	def_bool n

#==== for SD ====

config DBG_INIT_SCRIPT
    default "IT9860_360Mhz_DDR2_360Mhz.txt"

source "$CMAKE_SOURCE_DIR/sdk/Kconfig"
```

## project/test_ethernet/Kconfig
```kconfig
#
# For a description of the syntax of this configuration file,
# see Documentation/kbuild/kconfig-language.txt.
#

mainmenu "Project Configuration"

config CMAKE_SOURCE_DIR
	string
	option env="CMAKE_SOURCE_DIR"

config DEF_CHIP_PKG_IT9860
    def_bool y

config ROM_COMPRESS
	def_bool n

config UART1_ENABLE
	def_bool y
	
config GPIO_UART1_TX
	default "4"
	
config GPIO_UART1_RX
	default "-1"
	
config NOR_USE_AXISPI
	def_bool y
	
config NOR_ENABLE_QUADMODE
	def_bool y
	
#==== for Peripheral ====
config USB0_ENABLE
	def_bool y

config NOR_ENABLE
    def_bool y
#==== for NET ====
#IP101GR/RTL8201FL:     "27, 28, 29, 30, 31, 32, 33, 34, 35, 36"
config GPIO_ETHERNET
    default "27, 28, 29, 30, 31, 32, 33, 34, 35, 36"

config NET_ENABLE
    def_bool y
	
config NET_ETHERNET
    def_bool y

config DEF_NET_IP101GR
    def_bool y

if DEF_NET_RTL8201FL
config NET_ETHERNET_PHY_ADDR
    default "0"

config GPIO_ETHERNET_LINK
    default "39"
endif

if DEF_NET_IP101GR
config NET_ETHERNET_PHY_ADDR
    default "1"

config GPIO_ETHERNET_LINK
    default "37"
endif

config NET_ETHERNET_LINK_INTR
    def_bool y

config NET_ETHERNET_MAC_ADDR_RANDOM
    def_bool y

if NET_ETHERNET
config NET_ETHERNET_MAC_ADDR_STORAGE
    def_bool y
endif
	
if NET_ETHERNET_MAC_ADDR_STORAGE

config NET_ETHERNET_MAC_ADDR_POS
    default "0x70000"

config NET_ETHERNET_MAC_ADDR_UPGRADE
    def_bool y

endif

config NET_HTTP
	def_bool y
	
config PING
	def_bool y

config RAM_INIT_SCRIPT
	default "IT9860_264Mhz_DDR2_264Mhz.scr"
	
config DBG_INIT_SCRIPT
	default "IT9860_264Mhz_DDR2_264Mhz.txt"

source "$CMAKE_SOURCE_DIR/sdk/Kconfig"


menu "WIFI Ethernet Test"

choice
	prompt "Test App"
	default TEST_ETHERNET_LWIP


config TEST_ETHERNET_LWIP
	bool "Test by TCP socket"
	help
	    Connect to AP and test TCP

endchoice

endmenu
```

## project/test_ftp_client/Kconfig
```kconfig
#
# For a description of the syntax of this configuration file,
# see Documentation/kbuild/kconfig-language.txt.
#

mainmenu "Project Configuration"

config CTRLBOARD
    bool
    default y
    select HAVE_LCD
    select HAVE_GRAPHICS
    select HAVE_AUDIO
    select HAVE_VIDEO

config CMAKE_SOURCE_DIR
	string
	option env="CMAKE_SOURCE_DIR"

config USB0_ENABLE
    def_bool y

config MSC_ENABLE
    def_bool y

config FS_FAT
    def_bool y


config UART1_ENABLE
    def_bool y

config GPIO_UART1_TX
    default "4"

config GPIO_UART1_RX
    default "-1"

config NOR_ENABLE
    def_bool y

config NOR_USE_AXISPI
    def_bool y

config NOR_ENABLE_QUADMODE
    def_bool y

config NET_ENABLE
    def_bool y

config BUILD_INIPARSER
    def_bool y
    
config TASK_DRIVE_PROBE
    def_bool y

config DEF_DBG_UART1
    def_bool y

config SYSTEM_NAME
    default "ITE ftp client download test"

if NET_ENABLE
config NET_ETHERNET
    def_bool y

config GPIO_ETHERNET_LINK
    default "39"

config GPIO_ETHERNET
    default "25, 26, 27, 28, 29, 30, 31, 36, 37, 38"
    
config DEF_NET_RTL8201FL
    def_bool y

config NET_ETHERNET_PHY_ADDR
    default "0"
    
config NET_ETHERNET_LINK_INTR
    def_bool y

config NET_ETHERNET_MAC_ADDR_RANDOM
    def_bool y

config NET_ETHERNET_MAC_ADDR_STORAGE
    def_bool y

config NET_ETHERNET_MAC_ADDR_POS
    default "0x70000"

config NET_ETHERNET_MAC_ADDR_UPGRADE
    def_bool y

config NET_MAC_CLOCK_INVERSE
    default "1"
	
config NET_MAC_CLOCK_DELAY
    default "0x0F"

endif

config NET_WIFI
    def_bool n
    
if NET_WIFI
config NET_WIFI_WPA
    def_bool y

config NET_WIFI_SSID
    default "CtrlBoard"

config NET_WIFI_FIND_BEST_CHANNEL
    default n
	
config NET_WIFI_REDEFINE
	def_bool y

config NET_DHCP_SERVER
    def_bool y

config DHCPS_ADDR_COUNT
    default "254"

endif

config NET_HTTP
    def_bool y

config NET_FTP
    def_bool y

source "$CMAKE_SOURCE_DIR/sdk/Kconfig"
```

## project/test_gpio/Kconfig
```kconfig
#
# For a description of the syntax of this configuration file,
# see Documentation/kbuild/kconfig-language.txt.
#

mainmenu "Project Configuration"

config TEST_GPIO
    bool
    default y

config CMAKE_SOURCE_DIR
	string
	option env="CMAKE_SOURCE_DIR"

config DEF_CHIP_PKG_IT9860
    def_bool y  

config RAM_SIZE
    default "0x4000000"

config RAM_INIT_SCRIPT
    default "IT9860_360Mhz_DDR2_360Mhz.scr"
    
config GPIO_UART0_TX
    default "4"

config GPIO_UART0_RX
    default "-1"

config DBG_INIT_SCRIPT
    default "IT9860_360Mhz_DDR2_360Mhz.txt"
    

source "$CMAKE_SOURCE_DIR/sdk/Kconfig"

menu "GPIO Test"

choice
	prompt "Test GPIO"
	default TEST_GPIO_INPUT

config TEST_GPIO_INPUT
	bool "TEST_GPIO_INPUT"
	config GPIO_TEST_INPUT_PIN
        string "INPUT_PIN"
        depends on TEST_GPIO_INPUT
        default 5
	
config TEST_GPIO_OUTPUT_TO_INPUT
	bool "TEST_GPIO_OUTPUT_TO_INPUT"
	config GPIO_TEST_INPUT_PIN
        string "INPUT_PIN"
        depends on TEST_GPIO_OUTPUT_TO_INPUT
        default 5
	config GPIO_TEST_OUTPUT_PIN
        string "OUTPUT_PIN"
        depends on TEST_GPIO_OUTPUT_TO_INPUT
        default 6

config TEST_GPIO_INTERRUPT
	bool "TEST_GPIO_INTERRUPT"
	config GPIO_TEST_INTR_PIN
        string "INTR_PIN"
        depends on TEST_GPIO_INTERRUPT
        default 5
		
#config TEST_GPIO_EX_4
#	bool "TEST_GPIO_EX_4"

endchoice

endmenu
```

## project/test_gpio/Kconfig.win32
```kconfig
#
# For a description of the syntax of this configuration file,
# see Documentation/kbuild/kconfig-language.txt.
#

mainmenu "Project Configuration"

config CMAKE_SOURCE_DIR
	string
	option env="CMAKE_SOURCE_DIR"

source "$CMAKE_SOURCE_DIR/sdk/Kconfig"

menu "GPIO Test"

choice
	prompt "Test GPIO"
	default TEST_GPIO_INPUT

config TEST_GPIO_INPUT
	bool "TEST_GPIO_INPUT"
	config GPIO_TEST_INPUT_PIN
        string "INPUT_PIN"
        depends on TEST_GPIO_INPUT
        default 5
	
config TEST_GPIO_OUTPUT_TO_INPUT
	bool "TEST_GPIO_OUTPUT_TO_INPUT"
	config GPIO_TEST_INPUT_PIN
        string "INPUT_PIN"
        depends on TEST_GPIO_OUTPUT_TO_INPUT
        default 5
	config GPIO_TEST_OUTPUT_PIN
        string "OUTPUT_PIN"
        depends on TEST_GPIO_OUTPUT_TO_INPUT
        default 6

config TEST_GPIO_INTERRUPT
	bool "TEST_GPIO_INTERRUPT"
	config GPIO_TEST_INTR_PIN
        string "INTR_PIN"
        depends on TEST_GPIO_INTERRUPT
        default 5
		
#config TEST_GPIO_EX_4
#	bool "TEST_GPIO_EX_4"
		
endchoice

endmenu
```

## project/test_homebus/Kconfig
```kconfig
#
# For a description of the syntax of this configuration file,
# see Documentation/kbuild/kconfig-language.txt.
#

mainmenu "Project Configuration"

config TEST_PTHREAD
    bool
    default y
    #select HAVE_LCD
    #select HAVE_GRAPHICS
    #select HAVE_AUDIO
    #select HAVE_VIDEO

config CMAKE_SOURCE_DIR
    string
    option env="CMAKE_SOURCE_DIR"

config RAM_SIZE
    default "0x4000000"

config UART1_ENABLE
    def_bool y

config GPIO_UART1_TX
    default "4"

config GPIO_UART1_RX
    default "-1"

config DEF_DBG_UART1
    def_bool y

config ALT_CPU_ENABLE
    def_bool y

config HOMEBUS
    def_bool y

config GPIO_HOMEBUS_TXD
    default "35"

config UART2_ENABLE
    def_bool y

config DEF_UART2_FIFO
    def_bool y

config UART2_BAUDRATE
    default "9600"

config GPIO_UART2_TX
    default "-1"

config GPIO_UART2_RX
    default "37"

#config GPIO_HOMEBUS_RXD
#    default "37"

source "$CMAKE_SOURCE_DIR/sdk/Kconfig"
```

## project/test_iic/Kconfig
```kconfig
#
# For a description of the syntax of this configuration file,
# see Documentation/kbuild/kconfig-language.txt.
#

mainmenu "Project Configuration"

config TEST_IIC
    bool
    default y
    #select HAVE_LCD
    #select HAVE_GRAPHICS
    #select HAVE_AUDIO
    #select HAVE_VIDEO

config CMAKE_SOURCE_DIR
	string
	option env="CMAKE_SOURCE_DIR"

config UART1_ENABLE
    def_bool y

config GPIO_UART1_TX
    default "4"

config GPIO_UART1_RX
    default "-1"

config I2C2_ENABLE
    def_bool y

config I2C3_ENABLE
    def_bool y

source "$CMAKE_SOURCE_DIR/sdk/Kconfig"
```

## project/test_input/Kconfig
```kconfig
#
# For a description of the syntax of this configuration file,
# see Documentation/kbuild/kconfig-language.txt.
#

mainmenu "Project Configuration"

config TEST_INPUT
    bool
    default y
    select HAVE_LCD
    select HAVE_GRAPHICS
    select HAVE_AUDIO
    select HAVE_VIDEO

config CMAKE_SOURCE_DIR
    string
    option env="CMAKE_SOURCE_DIR"

config DEF_CHIP_PKG_IT9860
    def_bool y

config RAM_SIZE
    default "0x4000000"

config RAM_INIT_SCRIPT
    default "IT9860_264Mhz_DDR2_264Mhz.scr"

config DCPS_ENABLE
    def_bool y

config FONT_FILENAME
    default "WenQuanYiMicroHeiMono.ttf"

config BACKLIGHT_ENABLE
    def_bool y

config BACKLIGHT_DUTY_CYCLES
    default "95, 92, 88, 82, 75, 65, 55, 40, 25, 5"

config BACKLIGHT_DEFAULT_DUTY_CYCLE
    default "5"

config LCD_ENABLE
    def_bool y

config LCD_WIDTH
    default "1024"

config LCD_HEIGHT
    default "600"

config LCD_PITCH
    default "2048"

config LCD_INIT_SCRIPT
    default "DEMOIT9860_MIPI_JY_1024x600_24bits.txt"

config LCD_TRIPLE_BUFFER
    default n

config CMDQ_ENABLE
    def_bool y

config M2D_ENABLE
    def_bool y

config JPEG_HW_ENABLE
    def_bool y

config AUDIO_ENABLE
    def_bool y

config AUDIO_DAC_MODULE
    default "itp_dac_ite970.c"

config AUDIO_CODEC_MP3DEC
    def_bool y

config AUDIO_CODEC_WMADEC
    def_bool y

config AUDIO_CODEC_WAV
    def_bool y

config VIDEO_ENABLE
    def_bool y

config KEYPAD_ENABLE
    def_bool n

config USB0_ENABLE
    def_bool y

config MSC_ENABLE
    def_bool y

config FS_FAT
    def_bool y

config I2C1_ENABLE
    def_bool y

config GPIO_IIC1_CLK
    default "47"

config GPIO_IIC1_DATA
    default "46"

config TOUCH_ENABLE
    def_bool y

config TOUCH_MODULE
    default "gt911"

config TOUCH_X_MAX_VALUE
    default "0x3FF"

config TOUCH_Y_MAX_VALUE
    default "0x257"

config GPIO_TOUCH_INT
    default "44"

config GPIO_TOUCH_RESET
    default "45"

config GPIO_TOUCH_WAKE
    default "-1"

config DEF_TOUCH_I2C1
    def_bool y

config TOUCH_INTR
    def_bool y

config I2S_ENABLE
    def_bool y

config I2S_SPDIF_ENABLE
    def_bool n
    
config AXISPI_ENABLE
    def_bool n

config GPIO_UART0_TX
    default "4"

config GPIO_UART0_RX
    default "-1"

config GPIO_BACKLIGHT_PWM
    default "49"

config TASK_DRIVE_PROBE
    def_bool y

config DBG_INIT_SCRIPT
    default "IT9860_264Mhz_DDR2_264Mhz.txt"

config ITU_FT_CACHE_ENABLE
    def_bool y

config ITU_FT_CACHE_SIZE
    default "0xFA000"

config BUILD_ITU
    def_bool y

config BUILD_AUDIO_MGR
    def_bool y

config BUILD_SDL
    def_bool y

source "$CMAKE_SOURCE_DIR/sdk/Kconfig"

menu "INPUT Test"

choice
    prompt "Test App"
    default BUILD_PYINPUT

config BUILD_PYINPUT
    bool "Input Test"

endchoice

endmenu
```

## project/test_ir/Kconfig
```kconfig
#
# For a description of the syntax of this configuration file,
# see Documentation/kbuild/kconfig-language.txt.
#

mainmenu "Project Configuration"

config TEST_IR
    bool
    default y

config CMAKE_SOURCE_DIR
	string
	option env="CMAKE_SOURCE_DIR"
    
config DEF_CHIP_PKG_IT9860
    def_bool y

config RAM_INIT_SCRIPT
    default "IT9860_264Mhz_DDR2_264Mhz.scr"

config DBG_INIT_SCRIPT
    default "IT9860_264Mhz_DDR2_264Mhz.txt"

config FS_FAT
	def_bool n
    
config UART1_ENABLE
    def_bool y

config GPIO_UART1_TX
    default "4"

config GPIO_UART1_RX
    default "-1"

config IRDA_ENABLE
    def_bool y
	
config IR0_ENABLE
    def_bool y

config GPIO_IR0_TX
    default "14"

config GPIO_IR0_RX
    default "24"
	
source "$CMAKE_SOURCE_DIR/sdk/Kconfig"

menu "Test IR"

choice
	prompt "Test IR"
	default TEST_RTC_COUNT

config TEST_IR_RX
	bool "testing IR Rx"
	help
		test IR Rx receiving.
    help_cht
		測試IR Rx接收訊號。
    help_chs
		测试IR Rx接收讯号。
		
config TEST_IR_TXRX
	bool "testing IR Tx sig to Rx"
	help
		test IR Tx sending signal to Rx.
    help_cht
		測試IR Tx傳送訊號給Rx。
    help_chs
		测试IR Tx传送讯号给Rx。
		
config TEST_IR_SAMPLE
	bool "testing IR sampling function"
	help
		test IR Rx sampling function.
    help_cht
		測試IR Rx頻率偵測功能。
    help_chs
		测试IR Rx频率侦测功能。

endchoice

endmenu
```
