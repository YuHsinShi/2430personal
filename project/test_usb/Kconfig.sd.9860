## project/test_usb/Kconfig.sd.9860
```kconfig
#
# For a description of the syntax of this configuration file,
# see Documentation/kbuild/kconfig-language.txt.
#

mainmenu "Project Configuration"

config CMAKE_SOURCE_DIR
	string
	option env="CMAKE_SOURCE_DIR"

config DEF_CHIP_PKG_IT9860
	def_bool y
	
config ROM_COMPRESS
	def_bool n
	
#==== for SD ====
config SD0_ENABLE
	def_bool y

config SD0_STATIC
	default n
	
config GPIO_SD0_CARD_DETECT
    default "19"

config GPIO_SD0_POWER_ENABLE
    default "-1"

config GPIO_SD0_WRITE_PROTECT
    default "-1"
	
config GPIO_SD0_IO
      default "14, 13, 15, 16, 17, 18, -1, -1, -1, -1"
	
config SD1_ENABLE
	def_bool y

config SD1_STATIC
    default n

config GPIO_SD1_CARD_DETECT
    default "20"

config GPIO_SD1_POWER_ENABLE
    default "-1"

config GPIO_SD1_WRITE_PROTECT
    default "-1"

config GPIO_SD1_IO
      default "11, 13, 15, 16, 17, 18, -1, -1, -1, -1"

config UART1_ENABLE
    def_bool y

config GPIO_UART1_TX
    default "4"

config GPIO_UART1_RX
    default "-1"

#==== for FAT ====
config FS_FAT
	def_bool y
	
#==== for Task ====
config TASK_DRIVE_PROBE	
	def_bool y
		
#==== for Script ====
config DBG_INIT_SCRIPT
    default "IT9860_360Mhz_DDR2_360Mhz.txt"

source "$CMAKE_SOURCE_DIR/sdk/Kconfig"


menu "Storage Test"

choice
	prompt "Test App"
	default TEST_SD

config TEST_SD
	bool "SD Test"
	depends on (SD0_ENABLE || SD1_ENABLE)
	help
	    This is general storage test with itp. It can test multi-storage at the same time.
	    We can use this test project to run 2 SD.

endchoice

endmenu
```

## project/test_usb/Kconfig.transparent
```kconfig
#
# For a description of the syntax of this configuration file,
# see Documentation/kbuild/kconfig-language.txt.
#

mainmenu "Project Configuration"

config CMAKE_SOURCE_DIR
	string
	option env="CMAKE_SOURCE_DIR"

config UART1_ENABLE
    def_bool y

config GPIO_UART1_TX
    default "4"

config GPIO_UART1_RX
    default "-1"

config DEF_DBG_UART1
    def_bool y

config USB0_ENABLE
	def_bool y
	
config USB1_ENABLE
	def_bool y

config USB_DEVICE
	def_bool y
    
config DEF_USB_DEVICE_USB1
	def_bool y

config USBD_HID_MOUSE
	def_bool y

config USBD_HID_KBD
	def_bool y

config USB_HID_ENABLE
	def_bool y

config GPIO_USB_ID_PIN
    default "51"
    
config USB_HID
	def_bool y

source "$CMAKE_SOURCE_DIR/sdk/Kconfig"

menu "USB HID Test"

choice
	prompt "Test App"
	default TEST_HID_TRANSPARENT

config TEST_HID_TRANSPARENT
    bool "USB_HID_TRANSPARENT"
    depends on USB_HID

endchoice

endmenu
```

## project/test_usb/Kconfig.transport
```kconfig
#
# For a description of the syntax of this configuration file,
# see Documentation/kbuild/kconfig-language.txt.
#

mainmenu "Project Configuration"

config CMAKE_SOURCE_DIR
	string
	option env="CMAKE_SOURCE_DIR"

config UART1_ENABLE
    def_bool y

config GPIO_UART1_TX
    default "4"

config GPIO_UART1_RX
    default "-1"

config DEF_DBG_UART1
    def_bool y

config USB0_ENABLE
	def_bool y
	
#config USB1_ENABLE
#	def_bool y

config USB_HID_ENABLE
	def_bool y
    
config USB_HID
	def_bool y

source "$CMAKE_SOURCE_DIR/sdk/Kconfig"

menu "USB HID Test"

choice
	prompt "Test App"
	default TEST_HID_TRANSPORT

config TEST_HID_TRANSPORT
    bool "USB_HID_TRANSPORT"
    depends on USB_HID

endchoice

endmenu
```

## project/test_video/Kconfig
```kconfig
#
# For a description of the syntax of this configuration file,
# see Documentation/kbuild/kconfig-language.txt.
#

mainmenu "Project Configuration"

config TEST_VIDEO
    bool
    default y
    select HAVE_LCD
    select HAVE_GRAPHICS
    select HAVE_VIDEO
    select HAVE_AUDIO

config CMAKE_SOURCE_DIR
    string
    option env="CMAKE_SOURCE_DIR"

config RAM_SIZE
    default "0x4000000"

config LCD_ENABLE
    def_bool y

config LCD_WIDTH
    default "1024"

config LCD_HEIGHT
    default "600"

config LCD_PITCH
    default "2048"

config LCD_INIT_SCRIPT
    default "DEMOIT9860_MIPI_JY_1024x600_24bits.txt"

config BACKLIGHT_ENABLE
    def_bool y

config BACKLIGHT_DUTY_CYCLES
    default "95, 92, 88, 82, 75, 65, 55, 40, 25, 5"

config BACKLIGHT_DEFAULT_DUTY_CYCLE
    default "5"

config GPIO_BACKLIGHT_PWM
     default "95"

config CMDQ_ENABLE
    def_bool y

config JPEG_HW_ENABLE
    def_bool y

config M2D_ENABLE
    def_bool y

config UART1_ENABLE
    def_bool y

config GPIO_UART1_TX
    default "4"

config GPIO_UART1_RX
    default "-1"

config DEF_DBG_UART1
    def_bool y

config BUILD_FFMPEG
    def_bool y

config VIDEO_ENABLE
    def_bool y

config STC_ENABLE
    def_bool y

config FS_FAT
    def_bool y

config ITU_UCL_ENABLE
    def_bool y

config BUILD_INIPARSER
    def_bool y

config BUILD_ITU
    def_bool y

config BUILD_SDL
    def_bool y

config USB0_ENABLE
    def_bool y

config MSC_ENABLE
    def_bool y

config TASK_DRIVE_PROBE
    def_bool y

config I2S_ENABLE
    def_bool n

config I2S_OUTPUT_PIN_ENABLE
    def_bool n

config I2S_SPDIF_ENABLE
    def_bool n

config RECORD_VIDEO
    def_bool y

source "$CMAKE_SOURCE_DIR/sdk/Kconfig"

menu "Test H.264 / Mjpeg"

    choice
        prompt "Test H.264 / Mjpeg"
        default TEST_CONTAINER

    config TEST_ELEMENTARY
        bool "ElementaryStream format (h264, 264, etc)"

    config TEST_CONTAINER
        bool "Container format (MKV, MP4, etc)"

    config TEST_MJPEG
        bool "Container format (AVI)"

    #config TEST_GOLDEN
    #    bool "Golden bitstream file format (bmp)"

    endchoice

endmenu
```

## project/test_wiegand/Kconfig.win32
```kconfig
#
# For a description of the syntax of this configuration file,
# see Documentation/kbuild/kconfig-language.txt.
#

mainmenu "Project Configuration"

config TEST_WIEGAND_DEFAULT
    bool
    default y
    select HAVE_TWO_WIEGAND

config CMAKE_SOURCE_DIR
	string
	option env="CMAKE_SOURCE_DIR"

config DEF_CHIP_PKG_IT9860
    def_bool y  

config RAM_SIZE
    default "0x4000000"

config RAM_INIT_SCRIPT
    default "IT9860_360Mhz_DDR2_360Mhz.scr"

config GPIO_UART0_TX
    default "4"

config GPIO_UART0_RX
    default "-1"

config DBG_INIT_SCRIPT
    default "IT9860_360Mhz_DDR2_360Mhz.txt"
    
config WIEGAND_ENABLE
    def_bool y

config WIEGAND0_ENABLE
    def_bool y

config WIEGAND0_GPIO0
    default "24"

config WIEGAND0_GPIO1
    default "23"

source "$CMAKE_SOURCE_DIR/sdk/Kconfig"

menu "Wiegand Test"

choice
	prompt "Test App"
	default TEST_READ_CARD
	
config TEST_READ_CARD
	bool "READ_CARD"
	
config TEST_WIEGAND_OUT_O2I
	bool "WIEGAND_OUT_O2I"
	
endchoice

choice
	prompt "Test Source"
	default TEST_FROM_WIEGAND0
	
config TEST_FROM_WIEGAND0
	bool "FROM_WIEGAND0"
	
config TEST_FROM_WIEGAND1
	bool "FROM_WIEGAND1"
	
endchoice
	
endmenu
```

## project/test_wifi_ethernet/Kconfig
```kconfig
#
# For a description of the syntax of this configuration file,
# see Documentation/kbuild/kconfig-language.txt.
#

mainmenu "Project Configuration"

config CMAKE_SOURCE_DIR
    string
    option env="CMAKE_SOURCE_DIR"

config DEF_CHIP_PKG_IT9860
    def_bool y

config ROM_COMPRESS
    def_bool n

#==== for SD ====
config SD0_ENABLE
    def_bool n

config SD0_STATIC
    default n
config GPIO_SD1_IO
    default "11, 20, 6, 19, 8, 9, -1, -1, -1, -1"

config SDIO_ENABLE
   def_bool y

config  SDIO1_STATIC
   def_bool y

config AXISPI_ENABLE
    default n

config UART1_ENABLE
    def_bool y
	
config DEF_UART1_FIFO
	def_bool y
	
if DEF_UART1_FIFO
config UART_FORCE_FLUSH
	def_bool y
endif


config SPI0_MISO_GPIO
	default "-1"
	
config SPI0_MOSI_GPIO
	default "-1"
	
config SPI0_CLOCK_GPIO
	default "-1"
	
config SPI0_CHIP_SEL_GPIO
	default "-1"


config GPIO_UART1_TX
    default "4"

config GPIO_UART1_RX
    default "-1"

config SD1_ENABLE
    def_bool y

config MMC_ENABLE
      def_bool y

config SD1_STATIC
    def_bool n

config SDIO_ENABLE
      def_bool y

config SDIO1_STATIC
    def_bool y

config GPIO_SD1_WIFI_POWER_ENABLE
	def_bool y

#HMI: 11, 20, 15, 19, 17, 18, -1, -1, -1, -1
#Indoor: 11, 20, 6, 19, 8, 9, -1, -1, -1, -1
config GPIO_SD1_IO
      default "11, 20, 15, 19, 17, 18, -1, -1, -1, -1"

#======= for NET ========
config GPIO_ETHERNET_LINK
    default "37"

config GPIO_ETHERNET
    default "27, 28, 29, 30, 31, 32, 33, 34, 35, 36"


config NET_ENABLE
    def_bool y

config NET_ETHERNET
    def_bool y

config DEF_NET_IP101GR
    def_bool y

if NET_ENABLE
config NET_ETHERNET_LINK_INTR
    def_bool y

config NET_ETHERNET_MAC_ADDR_RANDOM
    def_bool y

config NET_ETHERNET_MAC_ADDR_UPGRADE
    def_bool y

config NET_ETHERNET_MAC_ADDR_STORAGE
    def_bool N

if NET_ETHERNET_MAC_ADDR_NOR
config NET_ETHERNET_MAC_ADDR_POS
    default "0x70000"
endif
endif
#========================

#======= for WIFI =======
config NET_WIFI
    def_bool y

config DEF_NET_WIFI_SDIO_NGPL
    def_bool y
	
if (NET_WIFI_SDIO_NGPL && GPIO_SD1_WIFI_POWER_ENABLE)
#HMI: 21,  Indoor: 16
config GPIO_SD1_WIFI_POWER_PIN
    default "21"

config SD1_WIFI_DETECT_ACTIVE_HIGH
    def_bool y


config NET_WIFI_SSID
    default "CtrlBoard"

config NET_WIFI_FIND_BEST_CHANNEL
    default n
	
config NET_WIFI_REDEFINE
	def_bool n

config NET_WIFI_MGR
	def_bool y


config NET_DHCP_SERVER
    def_bool y

config DHCPS_ADDR_COUNT
    default "254"
endif
#========================


config TASK_DRIVE_PROBE
    def_bool y

config DEF_DBG_UART1
    def_bool y

config DBG_STATS
    def_bool y

config DBG_STATS_HEAP
    def_bool y

config DEF_BUILD_MINSIZEREL
    def_bool y

config SYSTEM_NAME
    default "ITE Control Board ftp client download test"

config GCC_LTO
    def_bool y

config BUILD_INIPARSER
    def_bool y

config BUILD_PYINPUT
    def_bool y

config BUILD_MICROHTTPD
    def_bool y

config BUILD_XML2
    def_bool y

config PING
	def_bool y
	
config NET_HTTP
    def_bool y

config NET_FTP
    def_bool y



source "$CMAKE_SOURCE_DIR/sdk/Kconfig"
```

## project/test_wifi_sdio/Kconfig
```kconfig
#
# For a description of the syntax of this configuration file,
# see Documentation/kbuild/kconfig-language.txt.
#

mainmenu "Project Configuration"

config CMAKE_SOURCE_DIR
    string
    option env="CMAKE_SOURCE_DIR"

config DEF_CHIP_PKG_IT9860
    def_bool y

config ROM_COMPRESS
    def_bool n

#==== for SD ====
config SD0_ENABLE
    def_bool n

config SD0_STATIC
    default n

config AXISPI_ENABLE
    default n

config UART1_ENABLE
    def_bool y
	
config DEF_UART1_FIFO
	def_bool y
	
if DEF_UART1_FIFO
config UART_FORCE_FLUSH
	def_bool y
endif

#config GPIO_SD0_CARD_DETECT
#   default "98"

#config GPIO_SD0_POWER_ENABLE
#   default "99"

#config GPIO_SD0_WRITE_PROTECT
#   default "100"

#config  GPIO_SD1_POWER_ENABLE
#	default "21"

config SPI0_MISO_GPIO
	default "-1"
	
config SPI0_MOSI_GPIO
	default "-1"
	
config SPI0_CLOCK_GPIO
	default "-1"
	
config SPI0_CHIP_SEL_GPIO
	default "-1"

#HMI: 11, 20, 15, 19, 17, 18, -1, -1, -1, -1
#Indoor: 11, 20, 6, 19, 8, 9, -1, -1, -1, -1
config GPIO_SD0_IO
    default "11, 20, 15, 19, 17, 18, -1, -1, -1, -1"

config GPIO_UART1_TX
    default "4"

config GPIO_UART1_RX
    default "-1"

config SD1_ENABLE
    def_bool y

config MMC_ENABLE
      def_bool y

config SD1_STATIC
    def_bool n

config SDIO_ENABLE
      def_bool y

config SDIO1_STATIC
    def_bool y

config GPIO_SD1_WIFI_POWER_ENABLE
	def_bool y

#HMI: 11, 20, 15, 19, 17, 18, -1, -1, -1, -1
#Indoor: 11, 20, 6, 19, 8, 9, -1, -1, -1, -1
config GPIO_SD1_IO
      default "11, 20, 15, 19, 17, 18, -1, -1, -1, -1"
	  
#==== for NET ====
config NET_ENABLE
    def_bool y

config NET_WIFI
    def_bool y

config DEF_NET_WIFI_SDIO_NGPL
    def_bool y
	
if (NET_WIFI_SDIO_NGPL && GPIO_SD1_WIFI_POWER_ENABLE)
#HMI: 21,  Indoor: 16
config GPIO_SD1_WIFI_POWER_PIN
    default "21"

config SD1_WIFI_DETECT_ACTIVE_HIGH
    def_bool y
endif

config NET_WIFI_WPA
	def_bool n
	
config NET_WIFI_MGR
	def_bool y
	
config NET_HTTP
	def_bool n

config PING
	def_bool y

config DHCPS_ADDR_COUNT
    default "254"
    
config NET_WIFI_REDEFINE
	def_bool n

config DEF_BUILD_DEBUGREL
	def_bool y

config RAM_INIT_SCRIPT
	default "IT9860_264Mhz_DDR2_264Mhz.scr"
	
config DBG_INIT_SCRIPT
	default "IT9860_264Mhz_DDR2_264Mhz.txt"

source "$CMAKE_SOURCE_DIR/sdk/Kconfig"


menu "WIFI SDIO Test"

choice
    prompt "Test App"
    default TEST_SDIO_WIFI_LWIP

config TEST_SDIO_WIFI_LWIP
    bool "Test by TCP socket"
    help
        Connect to AP and test TCP

endchoice

endmenu
```

## project/test_wifi_usb/Kconfig
```kconfig
#
# For a description of the syntax of this configuration file,
# see Documentation/kbuild/kconfig-language.txt.
#

mainmenu "Project Configuration"

config CMAKE_SOURCE_DIR
	string
	option env="CMAKE_SOURCE_DIR"

config DEF_CHIP_PKG_IT9860
	def_bool y
	
config ROM_COMPRESS
	def_bool n

config UART1_ENABLE
	def_bool y
	
config GPIO_UART1_TX
	default "4"
	
config GPIO_UART1_RX
	default "-1"

#==== for USB ====
config USB0_ENABLE
	def_bool y

#==== for NET ====
config NET_ENABLE
	def_bool y
	
config NET_WIFI
	def_bool y

config DEF_NET_WIFI_8188EUS
	def_bool y
	
config NET_WIFI_WPA
	def_bool y
	
config NET_WIFI_MGR
	def_bool y

config NET_WIFI_REDEFINE
	def_bool y
	
config DHCPS_ADDR_COUNT
	default "254"

config PING
	def_bool y
	
config DEF_BUILD_DEBUGREL
	def_bool y

config RAM_INIT_SCRIPT
	default "IT9860_264Mhz_DDR2_264Mhz.scr"
	
config DBG_INIT_SCRIPT
	default "IT9860_264Mhz_DDR2_264Mhz.txt"

source "$CMAKE_SOURCE_DIR/sdk/Kconfig"


menu "WIFI USB Test"

choice
	prompt "Test App"
	default TEST_USB_WIFI_RAW


config TEST_USB_WIFI_LWIP
	bool "Test by TCP socket"
	help
	    Connect to AP and test TCP

endchoice

endmenu
```
