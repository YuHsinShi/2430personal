## sdk/driver/usb/gadget/Kconfig
```kconfig
#
# For a description of the syntax of this configuration file,
# see Documentation/kbuild/kconfig-language.txt.
#

choice
    prompt "USB Device module"
    depends on USB_DEVICE
    default USB_DEVICE_USB0 if DEF_USB_DEVICE_USB0
    default USB_DEVICE_USB1 if DEF_USB_DEVICE_USB1
    default USB_DEVICE_USB0

config USB_DEVICE_USB0
    bool "use USB0 module"
    depends on USB0_ENABLE
    help
        use USB0 module
    help_cht
        使用 USB0 的設備端功能。
    help_chs
        使用 USB0 的设备端功能。

config USB_DEVICE_USB1
    bool "use USB1 module"
    depends on USB1_ENABLE
    help
        use USB1 module
    help_cht
        使用 USB1 的設備端功能。
    help_chs
        使用 USB1 的设备端功能。

endchoice

#
# USB Gadget Drivers
#
config USBD_MASS_STORAGE
    bool "usb mass storage"
    depends on USB_DEVICE
    help
        The File Storage Gadget acts as a USB Mass Storage disk drive.
    help_cht
        設備端功能為大容量儲存設備。
    help_chs
        设备端功能为大容量储存设备。

config USBD_NCM
    bool "Network Control Model (CDC NCM)"
    depends on USB_DEVICE
    help
        The NCM protocol is used for exchanging High Speed Ethernet-framed data between the device and host.
    help_cht
        NCM協議用於在設備和主機之間交換高速以太網幀數據。
    help_chs
        NCM协议用于在设备和主机之间交换高速以太网帧数据。

config USBD_HID_DEVICE
    bool "HID-compliant device"
    depends on USB_DEVICE
    help
        Let the usb controller play the role of the HID-compliant device.
    help_cht
        使USB提供hid設備端的功能，使其在連接PC時可被視為一個HID-compliant device。
    help_chs
        使USB提供hid设备端的功能，使其在连接PC时可被视为一个HID-compliant device。
        
config USBD_HID_MOUSE
    bool "HID-compliant mouse"
    depends on USB_DEVICE
    help
        Let the usb controller play the role of the HID-compliant mouse.
    help_cht
        使USB提供hid設備端的功能，使其在連接PC時可被視為一個HID-compliant mouse。
    help_chs
        使USB提供hid设备端的功能，使其在连接PC时可被视为一个HID-compliant mouse。

config USBD_HID_KBD
    bool "HID Keyboard Device"
    depends on USB_DEVICE
    help
        Let the usb controller play the role of the HID Keyboard Device.
    help_cht
        使USB提供hid設備端的功能，使其在連接PC時可被視為一個HID Keyboard Device。
    help_chs
        使USB提供hid设备端的功能，使其在连接PC时可被视为一个HID Keyboard Device。

#config USBD_HID
#    def_bool y if (USBD_HID_DEVICE || USBD_HID_MOUSE || USBD_HID_KBD)

config USBD_ACM
    bool "Abstract Control Model (CDC ACM)"
    depends on USB_DEVICE
    help
        RS232 over USB.
        USB_VENDOR_ID must be 0x1D6B.
        USB_PRODUCT_ID must be 0x0106.
    help_cht
        USB模擬為UART。
        USB_VENDOR_ID必需為0x1D6B。
        USB_PRODUCT_ID必需為0x0106。
    help_chs
        USB模拟为UART。
        USB_VENDOR_ID必需为0x1D6B。
        USB_PRODUCT_ID必需为0x0106。

config DBG_USB
    bool "Debug Message Device"
    depends on USBD_ACM
    help
        Output message to USB.
    help_cht
        輸出除錯訊息到 USB 上。
    help_chs
        输出侦错讯息到 USB 上。
        
#config USBD_UVC
#    bool "usb video clase"
#    depends on USB_DEVICE
#    help
#        The usb video class
                

config USB_VENDOR_ID
    string "Vendor ID"
    depends on USB_DEVICE
    default "0x048D"
    help
        Vendor ID (assigned by the USB-IF).
    help_cht
        廠商識別碼。
    help_chs
        厂商标识符。

config USB_PRODUCT_ID
    string "Product ID"
    depends on USB_DEVICE
    default "0x0970"
    help
        Product ID (assigned by the manufacturer).
    help_cht
        產品識別碼。
    help_chs
        产品标识符。

config USBD_STR_MANUFACTURER
    string "Manufacturer String"
    depends on USB_DEVICE
    default "ITE Tech."
    help
        String descriptor describing manufacturer.
    help_cht
        製造商名稱字串。
    help_chs
        制造商名称字符串。

config USBD_STR_PRODUCT
    string "Product String"
    depends on USB_DEVICE
    default "Castor3"
    help
        String descriptor describing product.
    help_cht
        產品名稱字串。
    help_chs
        产品名称字符串。

config USBD_STR_SERIAL_NUMBER
    string
    prompt "Serial Number String" if DEV_DEVELOP
    depends on USB_DEVICE
    depends on USBD_MASS_STORAGE
    default "907012344321"
    help
        String descriptor describing the device's serial number. Need at least 12 uppercase hexadecimal characters, with a maximum of 126.
    help_cht
        序號指標。至少12個大寫16進制字符，最多126個。
    help_chs
        序号指标。至少12个大写16进制字符，最多126个。

config USB_DEVICE_DISKS
    string "USB Device Disks"
    depends on USB_DEVICE
    depends on USBD_MASS_STORAGE
    default "0, 1"
    help
        USB Device Disk Numbers. The maximum count is 4

        SD0       = 0,
        SD1       = 1,
        NAND      = 5,
        NOR       = 6,
        USB0 MSC0 = 7,
        USB0 MSC1 = 8,
        USB0 MSC2 = 9,
        USB0 MSC3 = 10,
        USB1 MSC0 = 15,
        USB1 MSC1 = 16,
        USB1 MSC2 = 17,
        USB1 MSC3 = 18,
        RAM Disk  = 23   => This is just for test only! It shall only has one disk if you choose this ram disk.
    help_cht
        指定磁碟號碼。最多可指定4個。可設定的磁碟號碼：

        SD0       = 0,
        SD1       = 1,
        NAND      = 5,
        NOR       = 6,
        USB0 MSC0 = 7,
        USB0 MSC1 = 8,
        USB0 MSC2 = 9,
        USB0 MSC3 = 10,
        USB1 MSC0 = 15,
        USB1 MSC1 = 16,
        USB1 MSC2 = 17,
        USB1 MSC3 = 18,
        RAM Disk  = 23 (此為測試用，且只能指定單一個磁碟)。
    help_chs
        指定磁盘号码。最多可指定4个。可设定的磁盘号码：

        SD0       = 0,
        SD1       = 1,
        NAND      = 5,
        NOR       = 6,
        USB0 MSC0 = 7,
        USB0 MSC1 = 8,
        USB0 MSC2 = 9,
        USB0 MSC3 = 10,
        USB1 MSC0 = 15,
        USB1 MSC1 = 16,
        USB1 MSC2 = 17,
        USB1 MSC3 = 18,
        RAM Disk  = 23 (此为测试用，且只能指定单一个磁盘)。

config USBD_LUN_VENDOR_ID
    string
    prompt "USB Device Vendor ID" if DEV_DEVELOP
    depends on USB_DEVICE
    depends on USBD_MASS_STORAGE
    default "'G','e','n','e','r','i','c',' '"
    help
        USB Device Vendor ID, need 8 bytes, format is like this: 'G','e','n','e','r','i','c',' '
    help_cht
        廠商識別字串，共8個字元，格式為: 'G','e','n','e','r','i','c',' '
    help_chs
        厂商标识符串，共8个字符，格式为: 'G','e','n','e','r','i','c',' '

config USBD_LUN0_PRODUCT_ID
    string
    prompt "USB Device Product ID at LUN #0" if DEV_DEVELOP
    depends on USB_DEVICE
    depends on USBD_MASS_STORAGE
    default "'S','t','o','r','a','g','e',' ','I','N','T','E','R','N','A','L'"
    help
        USB Device Product ID at LUN #0, need 16 bytes, format is like this: 'S','t','o','r','a','g','e',' ','I','N','T','E','R','N','A','L'
    help_cht
        第 0 個磁碟的產品識別字串，共16個字元，格式: 'S','t','o','r','a','g','e',' ','I','N','T','E','R','N','A','L'
    help_chs
        第 0 个磁盘的产品标识符串，共16个字符，格式: 'S','t','o','r','a','g','e',' ','I','N','T','E','R','N','A','L'

config USBD_LUN1_PRODUCT_ID
    string
    prompt "USB Device Product ID at LUN #1" if DEV_DEVELOP
    depends on USB_DEVICE
    depends on USBD_MASS_STORAGE
    default "'S','t','o','r','a','g','e',' ','C','A','R','D',' ','1',' ',' '"
    help
        USB Device Product ID at LUN #1, need 16 bytes, format is like this: 'S','t','o','r','a','g','e',' ','C','A','R','D',' ','1',' ',' '
    help_cht
        第 1 個磁碟的產品識別字串，共16個字元，格式: 'S','t','o','r','a','g','e',' ','C','A','R','D',' ','1',' ',' '
    help_chs
        第 1 个磁盘的产品标识符串，共16个字元，格式: 'S','t','o','r','a','g','e',' ','C','A','R','D',' ','1',' ',' '

config USBD_LUN2_PRODUCT_ID
    string
    prompt "USB Device Product ID at LUN #2" if DEV_DEVELOP
    depends on USB_DEVICE
    depends on USBD_MASS_STORAGE
    default "'S','t','o','r','a','g','e',' ','C','A','R','D',' ','2',' ',' '"
    help
        USB Device Product ID at LUN #2, need 16 bytes, format is like this: 'S','t','o','r','a','g','e',' ','C','A','R','D',' ','2',' ',' '
    help_cht
        第 2 個磁碟的產品識別字串，共16個字元，格式: 'S','t','o','r','a','g','e',' ','C','A','R','D',' ','2',' ',' '
    help_chs
        第 2 个磁盘的产品标识符串，共16个字元，格式: 'S','t','o','r','a','g','e',' ','C','A','R','D',' ','2',' ',' '

config USBD_LUN3_PRODUCT_ID
    string
    prompt "USB Device Product ID at LUN #3" if DEV_DEVELOP
    depends on USB_DEVICE
    depends on USBD_MASS_STORAGE
    default "'S','t','o','r','a','g','e',' ','C','A','R','D',' ','3',' ',' '"
    help
        USB Device Product ID at LUN #3, need 16 bytes, format is like this: 'S','t','o','r','a','g','e',' ','C','A','R','D',' ','3',' ',' '
    help_cht
        第 3 個磁碟的產品識別字串，共16個字元，格式: 'S','t','o','r','a','g','e',' ','C','A','R','D',' ','3',' ',' '
    help_chs
        第 3 个磁盘的产品标识符串，共16个字元，格式: 'S','t','o','r','a','g','e',' ','C','A','R','D',' ','3',' ',' '
```

## sdk/itu/share/Kconfig
```kconfig
#
# For a description of the syntax of this configuration file,
# see Documentation/kbuild/kconfig-language.txt.
#

source "$CMAKE_SOURCE_DIR/sdk/itu/share/itu/Kconfig"
```

## sdk/share/cli/Kconfig
```kconfig
#
# For a description of the syntax of this configuration file,
# see Documentation/kbuild/kconfig-language.txt.
#

if BUILD_CLI

menu "cli"

config CLI_ERR
    bool "Error Log"
    default y
    help
        Output error log.
    help_cht
        輸出錯誤訊息。
    help_chs
        输出错误讯息。

config CLI_WARN
    bool "Warning Log"
    default y
    help
        Output warning log.
    help_cht
        輸出警告訊息。
    help_chs
        输出警告讯息。

config CLI_INFO
    bool "Information Log"
    default y
    help
        Output information log.
    help_cht
        輸出資訊訊息。
    help_chs
        输出资讯讯息。

config CLI_DBG
    bool "Debug Log"
    default n
    help
        Output debug log.
    help_cht
        輸出除錯訊息。
    help_chs
        输出侦错讯息。

config CLI_USB_ACM
    bool "Command Line Interface by USB ACM protocol"
    depends on USBD_ACM
    default y
    help
        Command Line Interface by USB ACM protocol.
    help_cht
        開啟命令列功能, 使用USB ACM Protocol。
    help_chs
        开启命令行功能, 使用USB ACM Protocol。

config CLI_BUF_SIZE
    string "CLI used buffer size"
    default "0x20000"
    help
        CLI used buffer size.
    help_cht
        內部緩衝區記憶體大小。
    help_chs
        内部缓冲区内存大小。

endmenu

endif # BUILD_CLI
```

## sdk/share/cups/Kconfig
```kconfig
#
# For a description of the syntax of this configuration file,
# see Documentation/kbuild/kconfig-language.txt.
#

if BUILD_CUPS

config BUILD_OPENSSL
    def_bool y


endif # BUILD_QTBASE
```

## sdk/share/sdl/Kconfig
```kconfig
#
# For a description of the syntax of this configuration file,
# see Documentation/kbuild/kconfig-language.txt.
#

if BUILD_SDL

menu "sdl"

config SDL_M2D_ENABLE
    bool "Use M2D renderer"
    depends on M2D_ENABLE
    default n
    help
        Use M2D renderer or not.
    help_cht
        使用 M2D Renderer。
    help_chs
        使用 M2D Renderer。

endmenu

endif # BUILD_SDL
```

## sdk/share/tslib/Kconfig
```kconfig
#
# For a description of the syntax of this configuration file,
# see Documentation/kbuild/kconfig-language.txt.
#

if TOUCH_ENABLE

menu "tslib"

config TSLIB_STATIC_CONF
    bool "Static configuration"
    default n
    help
        Loading configuration from memory instead of from file.
    help_cht
        從記憶體而不是從檔案讀取設定。
    help_chs
        从内存而不是从文件加载配置。

endmenu

endif # TOUCH_ENABLE
```
