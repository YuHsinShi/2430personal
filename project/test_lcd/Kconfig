## project/test_sd/Kconfig
```kconfig
#
# For a description of the syntax of this configuration file,
# see Documentation/kbuild/kconfig-language.txt.
#

mainmenu "Project Configuration"

config CMAKE_SOURCE_DIR
    string
    option env="CMAKE_SOURCE_DIR"

config DEF_CHIP_PKG_IT9860
    def_bool y

config ROM_COMPRESS
    def_bool n

#==== for SD ====
config SD0_ENABLE
    def_bool y

config SD0_STATIC
    default n

config GPIO_SD0_CARD_DETECT
    default "19"

config GPIO_SD0_POWER_ENABLE
    default "-1"

config GPIO_SD0_WRITE_PROTECT
    default "-1"

config GPIO_SD0_IO
      default "14, 13, 15, 16, 17, 18, -1, -1, -1, -1"

config SD1_ENABLE
    def_bool y

config SD1_STATIC
    default n

config GPIO_SD1_CARD_DETECT
    default "20"

config GPIO_SD1_POWER_ENABLE
    default "-1"

config GPIO_SD1_WRITE_PROTECT
    default "-1"

config GPIO_SD1_IO
      default "11, 13, 15, 16, 17, 18, -1, -1, -1, -1"
    
config UART1_ENABLE
    def_bool y

config GPIO_UART1_TX
    default "4"

config GPIO_UART1_RX
    default "-1"

#==== for FAT ====
config FS_FAT
    def_bool y

#==== for Script ====
config DBG_INIT_SCRIPT
    default "IT9860_360Mhz_DDR2_360Mhz.txt"


source "$CMAKE_SOURCE_DIR/sdk/Kconfig"


menu "SD Test"

choice
    prompt "Test App"
    default TEST_SCAN_WINDOW

config TEST_SCAN_WINDOW
    bool "Scan window for SD"
    help
        Scan window for SD.

config TEST_SINGLE_SD
    bool "Test SD0 or SD1"
    help
        Test only one SD.

config TEST_TWO_SD
    bool "Test 2 SD"
    help
        Test 2 SD with 2 task.

config TEST_ERASE
    bool "Test Erase"
    help
        It will erase 512MB.

endchoice


choice
    prompt "Choose SD"
    default TEST_SD0
    depends on TEST_SINGLE_SD

config TEST_SD0
    bool "SD0"

config TEST_SD2
    bool "SD2"

endchoice



endmenu
```

## project/test_send_email/Kconfig
```kconfig
#
# For a description of the syntax of this configuration file,
# see Documentation/kbuild/kconfig-language.txt.
#

mainmenu "Project Configuration"

config CTRLBOARD
    bool
    default y
    select HAVE_LCD
    select HAVE_GRAPHICS
    select HAVE_AUDIO
    select HAVE_VIDEO

config CMAKE_SOURCE_DIR
	string
	option env="CMAKE_SOURCE_DIR"

config DEF_CHIP_PKG_IT9856
    def_bool y

config RAM_SIZE
    default "0x4000000"

config RAM_INIT_SCRIPT
    default "IT9850A0_360MHz.scr"


config USB0_ENABLE
    def_bool y


config MSC_ENABLE
    def_bool y


config NOR_ENABLE
    def_bool y
    
    
config FS_FAT
    def_bool y


config UART1_ENABLE
    def_bool y

config GPIO_UART1_TX
    default "4"

config GPIO_UART1_RX
    default "-1"

config UART0_ENABLE
    def_bool n

config GPIO_ETHERNET_LINK
    default "32"

config GPIO_ETHERNET
    default "33, 34, 35, 36, 90, 91, 92, 93, 94, 95"

config NET_ENABLE
    def_bool y

config NET_ETHERNET
    def_bool y

config NET_ETHERNET_LINK_INTR
    def_bool y

config NET_ETHERNET_MAC_ADDR_RANDOM
    def_bool y

config NET_ETHERNET_MAC_ADDR_STORAGE
    def_bool y

config NET_ETHERNET_MAC_ADDR_POS
    default "0x70000"

config DEF_NET_RTL8304MB
    def_bool y


config TASK_DRIVE_PROBE
    def_bool y

config DEF_DBG_UART1
    def_bool y

config DBG_INIT_SCRIPT
    default "IT9850A0_380MHz.txt"

config DBG_STATS
    def_bool y

config DBG_STATS_HEAP
    def_bool y

config DEF_BUILD_MINSIZEREL
    def_bool y

config SYSTEM_NAME
    default "ITE Control Board ftp client download test"

config GCC_LTO
    def_bool y

config BUILD_INIPARSER
    def_bool y

config BUILD_PYINPUT
    def_bool y

if NET_ENABLE
config NET_ETHERNET
    def_bool n

config NET_ETHERNET_LINK_INTR
    def_bool y

config NET_ETHERNET_MAC_ADDR_RANDOM
    def_bool y

config NET_ETHERNET_MAC_ADDR_STORAGE
    def_bool y

if NET_ETHERNET_MAC_ADDR_NOR

config NET_ETHERNET_MAC_ADDR_POS
    default "0x70000"

endif

config NET_ETHERNET_MAC_ADDR_UPGRADE
    def_bool y

config NET_DHCP_SERVER
	def_bool y

config DHCPS_ADDR_COUNT
  default "254"

config BUILD_MICROHTTPD
    def_bool y

config BUILD_XML2
    def_bool y
endif

config NET_WIFI
    def_bool n
   
if NET_WIFI
config NET_WIFI_WPA
    def_bool y

config NET_WIFI_SSID
    default "CtrlBoard"

config NET_WIFI_FIND_BEST_CHANNEL
    default n
	
config NET_WIFI_REDEFINE
	def_bool n

config NET_ETHERNET_WIFI
    def_bool n


config NET_DHCP_SERVER
    def_bool n

config DHCPS_ADDR_COUNT
    default "254"


config PING
	def_bool n
	
config CTRLBOARD_REDUCE_PBUFSIZE
    def_bool y
endif

config NET_HTTP
    def_bool y

config NET_FTP
    def_bool y

config NET_SMTP
    def_bool y	
	
source "$CMAKE_SOURCE_DIR/sdk/Kconfig"
```

## project/test_sw_pwm/Kconfig
```kconfig
#
# For a description of the syntax of this configuration file,
# see Documentation/kbuild/kconfig-language.txt.
#

mainmenu "Project Configuration"

config TEST_PTHREAD
    bool
    default y
    #select HAVE_LCD
    #select HAVE_GRAPHICS
    #select HAVE_AUDIO
    #select HAVE_VIDEO

config CMAKE_SOURCE_DIR
    string
    option env="CMAKE_SOURCE_DIR"

config RAM_SIZE
    default "0x4000000"

config UART1_ENABLE
    def_bool y

config GPIO_UART1_TX
    default "4"

config GPIO_UART1_RX
    default "-1"

config DEF_DBG_UART1
    def_bool y

config ALT_CPU_ENABLE
    def_bool y

config SW_PWM
    def_bool y

config SW_PWM0_ENABLE
    def_bool y

config SW_PWM0_CLOCK
    default "1000"

config SW_PWM0_DUTY_CYCLE
    default "50"

config GPIO_SW_PWM0
    default "86"

config SW_PWM1_ENABLE
    def_bool y

config SW_PWM1_CLOCK
    default "2000"

config SW_PWM1_DUTY_CYCLE
    default "20"

config GPIO_SW_PWM1
    default "87"

config SW_PWM2_ENABLE
    def_bool y

config SW_PWM2_CLOCK
    default "3000"

config SW_PWM2_DUTY_CYCLE
    default "70"

config GPIO_SW_PWM2
    default "88"

config SW_PWM3_ENABLE
    def_bool y

config SW_PWM3_CLOCK
    default "500"

config SW_PWM3_DUTY_CYCLE
    default "55"

config GPIO_SW_PWM3
    default "89"

source "$CMAKE_SOURCE_DIR/sdk/Kconfig"
```

## project/test_timer/Kconfig
```kconfig
#
# For a description of the syntax of this configuration file,
# see Documentation/kbuild/kconfig-language.txt.
#

mainmenu "Project Configuration"

config PROJECT_MODULE_DEFINED
    bool
    default y
    select HAVE_LCD
    select HAVE_GRAPHICS
    select HAVE_AUDIO
    select HAVE_VIDEO

config CMAKE_SOURCE_DIR
    string
    option env="CMAKE_SOURCE_DIR"

config DEF_CHIP_PKG_IT9860
    def_bool y

config RAM_INIT_SCRIPT
    default "IT9860_264Mhz_DDR2_264Mhz.scr"

config DBG_INIT_SCRIPT
    default "IT9860_264Mhz_DDR2_264Mhz.txt"

config UART1_ENABLE
    def_bool y

config GPIO_UART1_TX
    default "4"

config LCD_ENABLE
    def_bool y

config LCD_WIDTH
    default "1024"

config LCD_HEIGHT
    default "600"

config LCD_PITCH
    default "2048"

config LCD_INIT_SCRIPT
    default "DEMOIT9860_MIPI_JY_1024x600_24bits.txt"

config BACKLIGHT_ENABLE
    def_bool y

config BACKLIGHT_DUTY_CYCLES
    default "95, 92, 88, 82, 75, 65, 55, 40, 25, 5"

config GPIO_BACKLIGHT_PWM
    default "49"
    
config GPIO_PWM_NUMBER
    default "4"
    
config GPIO_PWM_MODE
    default "3"

config BACKLIGHT_DEFAULT_DUTY_CYCLE
    default "5"

source "$CMAKE_SOURCE_DIR/sdk/Kconfig"

menu "TEST TIMER"

choice
    prompt "TIMER TEST"
    default TIMER_BASIC_TEST
    help
        Test Timer.
    help_cht
        測試 Timer
    help_chs
        測試 Timer

config TIMER_BASIC_TEST
    bool "basic timer test"
    help
        basic timer test.
    help_cht
        timer 測試。
    help_chs
        timer 測試。
config TIMER_TIMEOUT_TEST
    bool "timeout test"
    help
        timeout test.
    help_cht
        timeout 測試。
    help_chs
        timeout 測試。

config TIMER_IRQ_TEST
    bool "interrupt request test "
    help
        test interrupt request.
    help_cht
        測試IRQ (Interrupt Request)。
    help_chs
        測試IRQ (Interrupt Request)。

config TIMER_PWM_BACKLIGHT_TEST
    bool "pwm backlight test "
    help
        test pwm(backlight module adjust luminance).
    help_cht
        測試PWM (背光模組調整亮度)。
    help_chs
        測試PWM (背光模組調整亮度)。

config TIMER_PWM_LED_TEST
    bool "pwm LED test "
    help
        test pwm(LED module adjust luminance).
    help_cht
        測試PWM (LED調整亮度)。
    help_chs
        測試PWM (LED調整亮度)。

config TIMER_PWM_ALL_PIN_TEST
    bool "pwm all Pin test"
    help
        test all pwm with all pin(test with Oscilloscope).
    help_cht
        於所有Pin上測試PWM1-8 (搭配示波器測試)。
    help_chs
        于所有Pin上测试PWM1-8 (搭配示波器测试)。

    endchoice

endmenu
```

## project/test_touch/Kconfig
```kconfig
#
# For a description of the syntax of this configuration file,
# see Documentation/kbuild/kconfig-language.txt.
#

mainmenu "Project Configuration"

config TEST_TOUCH
    bool
    default y
    select HAVE_LCD
    select HAVE_GRAPHICS
    #select HAVE_AUDIO
    #select HAVE_VIDEO

config CMAKE_SOURCE_DIR
	string
	option env="CMAKE_SOURCE_DIR"

config RAM_SIZE
    default "0x4000000"

config AXISPI_ENABLE
    def_bool n
    
config SPI_ENABLE
    def_bool n

config SPI0_ENABLE
    def_bool n

config I2C1_ENABLE
    def_bool y

config GPIO_IIC1_CLK
    default "37"

config GPIO_IIC1_DATA
    default "36"

config DEF_TOUCH_I2C1
    def_bool y

config TOUCH_ENABLE
	def_bool y

config TOUCH_MODULE
	default "gt911"

config TOUCH_INTR
	def_bool y

config TOUCH_X_MAX_VALUE
	default "0x3FF"

config TOUCH_Y_MAX_VALUE
	default "0x257"

config GPIO_TOUCH_INT
	default "38"

config GPIO_TOUCH_WAKE
	default "-1"

config GPIO_TOUCH_RESET
	default "39"
	
config UART1_ENABLE
    def_bool y

config GPIO_UART1_TX
    default "4"

config GPIO_UART1_RX
    default "-1"

config BUILD_TSLIB
	def_bool y

config BUILD_FAT
	def_bool y

config BUILD_SDL
	def_bool y

config USB0_ENABLE
	def_bool n

config MSC_ENABLE
	def_bool n

config FS_FAT
	def_bool y

#config LCD_ENABLE
#	def_bool y

#config LCD_WIDTH
#    default "1024"

#config LCD_HEIGHT
#    default "600"

#config LCD_INIT_SCRIPT
#    default "IT9850_LCD_800_480_Allentech_7inch_565.txt.in"

#config TASK_DRIVE_PROBE
#	def_bool y

config TSLIB_STATIC_CONF
	def_bool y
	
source "$CMAKE_SOURCE_DIR/sdk/Kconfig"
```

## project/test_uart/Kconfig
```kconfig
#
# For a description of the syntax of this configuration file,
# see Documentation/kbuild/kconfig-language.txt.
#

mainmenu "Project Configuration"

config TEST_UART
    bool
    default y

config DEF_CHIP_PKG_IT9860
    def_bool y

config RAM_INIT_SCRIPT
    default "IT9860_264Mhz_DDR2_264Mhz.scr"

config CMAKE_SOURCE_DIR
    string
    option env="CMAKE_SOURCE_DIR"

config FS_FAT
    def_bool n

config UART0_ENABLE
    def_bool y

config UART1_ENABLE
    def_bool y

config GPIO_UART1_TX
    default "4"

config GPIO_UART1_RX
    default "-1"

config NOR_ENABLE
    def_bool y

config SPI_ENABLE

config DEF_DBG_UART1
    def_bool y

config UART_INTR
    def_bool y

config DBG_INIT_SCRIPT
    default "IT9860_264Mhz_DDR2_264Mhz.txt"

source "$CMAKE_SOURCE_DIR/sdk/Kconfig"
```
