## project/test_lcd/Kconfig
```kconfig
#
# For a description of the syntax of this configuration file,
# see Documentation/kbuild/kconfig-language.txt.
#

mainmenu "Project Configuration"

config TEST_LCD
    bool
    default y
    select HAVE_LCD
    select HAVE_GRAPHICS
    select HAVE_VIDEO

config CMAKE_SOURCE_DIR
    string
    option env="CMAKE_SOURCE_DIR"

config RAM_SIZE
    default "0x4000000"

config LCD_ENABLE
    def_bool y

config ENABLE_ROTATE
	def_bool y
config LCD_WIDTH
    default "1280"

config LCD_HEIGHT
    default "480"

config LCD_PITCH
    default "2560"

config LCD_INIT_SCRIPT
    default "IT9860_MIPI_TL068HWXH08_EK79030_480x1280_4LANE_byteclk53.txt"

config BACKLIGHT_ENABLE
    def_bool y

config BACKLIGHT_DUTY_CYCLES
    default "95, 92, 88, 82, 75, 65, 55, 40, 25, 5"

config BACKLIGHT_DEFAULT_DUTY_CYCLE
    default "5"

config GPIO_BACKLIGHT_PWM
     default "49"

config GPIO_UART0_TX
    default "4"

config GPIO_UART0_RX
    default "-1"

config DBG_INIT_SCRIPT
    default "IT9860_360Mhz_DDR2_360Mhz.txt"

source "$CMAKE_SOURCE_DIR/sdk/Kconfig"

menu "LCD Test"

    choice
        prompt "Test App"
        default TEST_LCD_COLOR

    config TEST_LCD_COLOR
        bool "LCD_COLOR"

    config TEST_LCD_INTR
        bool "LCD_INTR"

    config TEST_LCDCONSOLE
        bool "LCDCONSOLE"

    config TEST_OSDCONSOLE
        bool "OSDCONSOLE"

    config TEST_BACKLIGHT
        bool "BACKLIGHT"

    config TEST_STNLCD
        bool "STNLCD"

    endchoice

endmenu
```

## project/test_lcd/Kconfig.win32
```kconfig
#
# For a description of the syntax of this configuration file,
# see Documentation/kbuild/kconfig-language.txt.
#

mainmenu "Project Configuration"

config TEST_LCD
    bool
    default y
    select HAVE_LCD
    select HAVE_GRAPHICS
    select HAVE_AUDIO
    select HAVE_VIDEO

config CMAKE_SOURCE_DIR
    string
    option env="CMAKE_SOURCE_DIR"

config RAM_SIZE
    default "0x4000000"

config LCD_ENABLE
    def_bool y

config LCD_WIDTH
    default "1024"

config LCD_HEIGHT
    default "600"

config LCD_PITCH
    default "2048"

config LCD_INIT_SCRIPT
    default "DEMOIT9860_MIPI_JY_1024x600_24bits.txt"

config BACKLIGHT_ENABLE
    def_bool y

config BACKLIGHT_DUTY_CYCLES
    default "95, 92, 88, 82, 75, 65, 55, 40, 25, 5"

config BACKLIGHT_DEFAULT_DUTY_CYCLE
    default "5"

config GPIO_BACKLIGHT_PWM
     default "64"

source "$CMAKE_SOURCE_DIR/sdk/Kconfig"

menu "LCD Test"

    choice
        prompt "Test App"
        default TEST_LCD_COLOR

    config TEST_LCD_COLOR
        bool "LCD_COLOR"

    config TEST_LCD_INTR
        bool "LCD_INTR"

    config TEST_LCDCONSOLE
        bool "LCDCONSOLE"

    config TEST_OSDCONSOLE
        bool "OSDCONSOLE"

    config TEST_BACKLIGHT
        bool "BACKLIGHT"

    config TEST_STNLCD
        bool "STNLCD"

    endchoice

endmenu
```

## project/test_nor/Kconfig
```kconfig
#
# For a description of the syntax of this configuration file,
# see Documentation/kbuild/kconfig-language.txt.
#

mainmenu "Project Configuration"

config DEF_CHIP_PKG_IT9860
    def_bool y

#config DEF_CHIP_PKG_IT9852
#    def_bool y

config RAM_INIT_SCRIPT
    default "IT9860_360Mhz_DDR2_360Mhz.scr"

config CMAKE_SOURCE_DIR
	string
	option env="CMAKE_SOURCE_DIR"

config FS_FAT
	def_bool n

config NOR_ENABLE
	def_bool y

config UART1_ENABLE
    def_bool y

config GPIO_UART1_TX
    default "4"

config GPIO_UART1_RX
    default "-1"

config SPI_ENABLE

config DEF_DBG_UART1
    def_bool y

config DBG_INIT_SCRIPT
    default "IT9860_360Mhz_DDR2_360Mhz.txt"

source "$CMAKE_SOURCE_DIR/sdk/Kconfig"
```

## project/test_nor/Kconfig.win32
```kconfig
#
# For a description of the syntax of this configuration file,
# see Documentation/kbuild/kconfig-language.txt.
#

mainmenu "Project Configuration"

config CMAKE_SOURCE_DIR
	string
	option env="CMAKE_SOURCE_DIR"
	
config FS_FAT
	def_bool n
	
config NOR_ENABLE
	def_bool y
	
config UART1_ENABLE
    def_bool y
	
config SPI_ENABLE
	def_bool y	

source "$CMAKE_SOURCE_DIR/sdk/Kconfig"
```

## project/test_pattern_gen/Kconfig
```kconfig
#
# For a description of the syntax of this configuration file,
# see Documentation/kbuild/kconfig-language.txt.
#

mainmenu "Project Configuration"

config TEST_PTHREAD
    bool
    default y
    #select HAVE_LCD
    #select HAVE_GRAPHICS
    #select HAVE_AUDIO
    #select HAVE_VIDEO

config CMAKE_SOURCE_DIR
    string
    option env="CMAKE_SOURCE_DIR"

config RAM_SIZE
    default "0x4000000"

config UART1_ENABLE
    def_bool y

config GPIO_UART1_TX
    default "4"

config GPIO_UART1_RX
    default "-1"

config DEF_DBG_UART1
    def_bool y

config ALT_CPU_ENABLE
    def_bool y

config PATTERN_GEN
    def_bool y


source "$CMAKE_SOURCE_DIR/sdk/Kconfig"
```

## project/test_peripheral/Kconfig
```kconfig
#
# For a description of the syntax of this configuration file,
# see Documentation/kbuild/kconfig-language.txt.
#

mainmenu "Project Configuration"

config TEST_PERIPHERAL
    bool
    default y
    #select HAVE_LCD
    #select HAVE_GRAPHICS
    #select HAVE_AUDIO
    #select HAVE_VIDEO

config CMAKE_SOURCE_DIR
    string
    option env="CMAKE_SOURCE_DIR"

config DEF_CHIP_PKG_IT9860
    def_bool y

config RAM_INIT_SCRIPT
    default "IT9860_264Mhz_DDR2_264Mhz.scr"

config DBG_INIT_SCRIPT
    default "IT9860_264Mhz_DDR2_264Mhz.txt"

config I2C0_ENABLE
    default n

config KEYPAD_ENABLE
    def_bool y

config KEYPAD_MODULE
    default "itp_keypad_castor3.c"

config KEYPAD_MAPPING_TABLE
    default "keypad_doorbell_indoor_4key.inc"

config TOUCH_KEYPAD_SET_KEY_NUMBER_ENABLE
    def_bool n

config GPIO_KEYPAD
    default "41, 42, 43, 44"

config TOUCH_KEY_USE_I2C
    def_bool n

config UART1_ENABLE
    def_bool y

config GPIO_UART1_TX
    default "4

config GPIO_UART1_RX
    default "-1"

config GPIO_LED
    default "40"

source "$CMAKE_SOURCE_DIR/sdk/Kconfig"

menu "Peripheral Test"

choice
    prompt "Test App"
    default TEST_KEYPAD

config TEST_KEYPAD
    bool "Keypad"
    depends on KEYPAD_ENABLE

config TEST_IR
    bool "IR"
    depends on (IR0_ENABLE || IR1_ENABLE || IR2_ENABLE || IR3_ENABLE)

config TEST_GET_CLK_SAMPLE
    bool "GET CLK SAMPLE"
    depends on (IR0_ENABLE || IR1_ENABLE || IR2_ENABLE || IR3_ENABLE) && CHIP_FAMILY_IT9860

config TEST_LED
    bool "LED"
    depends on LED_ENABLE

config TEST_RTC
    bool "RTC"
    depends on RTC_ENABLE

endchoice

endmenu
```

## project/test_pthread/Kconfig
```kconfig
#
# For a description of the syntax of this configuration file,
# see Documentation/kbuild/kconfig-language.txt.
#

mainmenu "Project Configuration"

config TEST_PTHREAD
    bool
    default y
    #select HAVE_LCD
    #select HAVE_GRAPHICS
    #select HAVE_AUDIO
    #select HAVE_VIDEO

config CMAKE_SOURCE_DIR
    string
    option env="CMAKE_SOURCE_DIR"

config RAM_SIZE
    default "0x4000000"

config GPIO_UART0_TX
    default "4"

config GPIO_UART0_RX
    default "-1"

source "$CMAKE_SOURCE_DIR/sdk/Kconfig"
```

## project/test_qrencode/Kconfig
```kconfig
#
# For a description of the syntax of this configuration file,
# see Documentation/kbuild/kconfig-language.txt.
#

mainmenu "Project Configuration"

config TEST_QRDECODE
    bool
    default y
    select HAVE_LCD
    select HAVE_GRAPHICS
    select HAVE_AUDIO
    select HAVE_VIDEO

config BUILD_QRENCODE
    def_bool y

config GCC_LTO
    def_bool y

config BUILD_PNG
    def_bool y

config CMAKE_SOURCE_DIR
    string
    option env="CMAKE_SOURCE_DIR"

config USB0_ENABLE
    def_bool y

config MSC_ENABLE
    def_bool y

config TASK_DRIVE_PROBE
    def_bool y

config FS_FAT
    def_bool y

config DEF_CHIP_PKG_IT9860
    def_bool y

config RAM_SIZE
    default "0x4000000"

config RAM_INIT_SCRIPT
    default "IT9860_360Mhz_DDR2_360Mhz.scr"

config DCPS_ENABLE
    def_bool y

config LCD_ENABLE
    def_bool y

config LCD_WIDTH
    default "1024"

config LCD_HEIGHT
    default "600"

config LCD_PITCH
    default "2048"

config LCD_INIT_SCRIPT
    default "DEMOIT9860_MIPI_JY_1024x600_24bits.txt"

config BACKLIGHT_ENABLE
    def_bool y

config BACKLIGHT_DUTY_CYCLES
    default "95, 92, 88, 82, 75, 65, 55, 40, 25, 5"

config BACKLIGHT_DEFAULT_DUTY_CYCLE
    default "5"

config GPIO_BACKLIGHT_PWM
    default "49"

config GPIO_PWM_NUMBER
    default "4"

config CMDQ_ENABLE
    def_bool y

config M2D_ENABLE
    def_bool y

config AUDIO_ENABLE
    def_bool n

config VIDEO_ENABLE
    def_bool y

config KEYPAD_ENABLE
    def_bool n

config USB0_ENABLE
    def_bool y

config MSC_ENABLE
    def_bool y

config FS_FAT
    def_bool y

config I2C2_ENABLE
    def_bool y

config GPIO_IIC2_CLK
    default "47"

config GPIO_IIC2_DATA
    default "46"

config SPI_ENABLE
    def_bool n

config AXISPI_ENABLE
    def_bool y

config I2S_ENABLE
    def_bool n

config I2S_SPDIF_ENABLE
    def_bool n

config TOUCH_ENABLE
    def_bool y

config TOUCH_INTR
    def_bool y

config TOUCH_MODULE
    default "gt911"

config TOUCH_X_MAX_VALUE
    default "0x3FF"

config TOUCH_Y_MAX_VALUE
    default "0x257"

config GPIO_TOUCH_INT
    default "45"

config GPIO_TOUCH_WAKE
    default "-1"

config GPIO_TOUCH_RESET
    default "44"

config DEF_TOUCH_I2C1
    def_bool y

config UART1_ENABLE
    def_bool y

config GPIO_UART1_TX
    default "4"

config GPIO_UART1_RX
    default "-1"

config TASK_DRIVE_PROBE
    def_bool y

config DEF_DBG_UART1
    def_bool y

config DBG_INIT_SCRIPT
    default "IT9860_360Mhz_DDR2_360Mhz.txt"

config ITU_FT_CACHE_ENABLE
    def_bool y

config BUILD_ITU
    def_bool y

config BUILD_SDL
    def_bool y

config DEF_BUILD_MINSIZEREL
    def_bool y




source "$CMAKE_SOURCE_DIR/sdk/Kconfig"
```

## project/test_rs485/Kconfig
```kconfig
#
# For a description of the syntax of this configuration file,
# see Documentation/kbuild/kconfig-language.txt.
#

mainmenu "Project Configuration"

config TEST_RS485
    bool
    default y

config CMAKE_SOURCE_DIR
    string
    option env="CMAKE_SOURCE_DIR"

config DEF_CHIP_PKG_IT9860
    def_bool y

config DEF_CPU_FA626
    def_bool y

config RAM_SIZE
    default "0x4000000"

config RAM_INIT_SCRIPT
    default "IT9860_264Mhz_DDR2_264Mhz.scr"

config GPIO_UART0_TX
    default "4"

config GPIO_UART0_RX
    default "-1"

config DBG_INIT_SCRIPT
    default "IT9860_264Mhz_DDR2_264Mhz.txt"

config UART1_ENABLE
    def_bool y
	
config UART1_RS485
	def_bool y

config GPIO_UART1_TX
    default "41"

config GPIO_RS485_1_TX_ENABLE
    default "42"

config GPIO_UART1_RX
    default "40"

source "$CMAKE_SOURCE_DIR/sdk/Kconfig"
```

## project/test_rtc/Kconfig
```kconfig
#
# For a description of the syntax of this configuration file,
# see Documentation/kbuild/kconfig-language.txt.
#

mainmenu "Project Configuration"

config TEST_RTC
    bool
    default y
    #select HAVE_LCD
    #select HAVE_GRAPHICS
    #select HAVE_AUDIO
    #select HAVE_VIDEO

config CMAKE_SOURCE_DIR
	string
	option env="CMAKE_SOURCE_DIR"
    
config DEF_CHIP_PKG_IT9860
    def_bool y

config RAM_INIT_SCRIPT
    default "IT9860_264Mhz_DDR2_264Mhz.scr"

config DBG_INIT_SCRIPT
    default "IT9860_264Mhz_DDR2_264Mhz.txt"

config FS_FAT
	def_bool n

config RTC_ENABLE
    def_bool y
    
config UART1_ENABLE
    def_bool y

config GPIO_UART1_TX
    default "4"

config GPIO_UART1_RX
    default "-1"

source "$CMAKE_SOURCE_DIR/sdk/Kconfig"

menu "Test RTC"

choice
	prompt "Test RTC"
	default TEST_RTC_COUNT

config TEST_RTC_COUNT
	bool "testing RTC counting"
	help
		test RTC counting.
    help_cht
		測試RTC計時。
    help_chs
		测试RTC计时。

config TEST_RTC_MS
	bool "testing RTC microseconds counting"
	help
		test RTC counting in microseconds.
    help_cht
		測試RTC以微秒計時。
    help_chs
		测试RTC以微秒计时。

config TEST_RTC_ALARM
	bool "testing RTC alarm triggering"
	help
		test RTC alarm triggering.
    help_cht
		測試RTC鬧鐘功能。
    help_chs
		测试RTC闹钟功能。

endchoice

endmenu
```

## project/test_rtc/Kconfig.win32
```kconfig
#
# For a description of the syntax of this configuration file,
# see Documentation/kbuild/kconfig-language.txt.
#

mainmenu "Project Configuration"

config TEST_RTC
    bool
    default y
    #select HAVE_LCD
    #select HAVE_GRAPHICS
    #select HAVE_AUDIO
    #select HAVE_VIDEO

config CMAKE_SOURCE_DIR
    string
    option env="CMAKE_SOURCE_DIR"

config RTC_ENABLE
    def_bool y

source "$CMAKE_SOURCE_DIR/sdk/Kconfig"

menu "RTC Test"

choice
    prompt "Test App"
    default TEST_RTC

config RTC_TEST
    bool "Enable Rtc Test"

endchoice

endmenu
```

## project/test_saradc/Kconfig
```kconfig
#
# For a description of the syntax of this configuration file,
# see Documentation/kbuild/kconfig-language.txt.
#

mainmenu "Project Configuration"

config DEF_CHIP_PKG_IT9860
    def_bool y

config CMAKE_SOURCE_DIR
    string
    option env="CMAKE_SOURCE_DIR"

config UART1_ENABLE
    def_bool y

config GPIO_UART1_TX
    default "4"

config GPIO_UART1_RX
    default "-1"

config AXISPI_ENABLE
    def_bool n

config SPI_ENABLE
    def_bool n

config DEF_DBG_UART1
    def_bool y

config RAM_INIT_SCRIPT
    default "IT9860_360Mhz_DDR2_360Mhz.scr"

config DBG_INIT_SCRIPT
    default "IT9860_360Mhz_DDR2_360Mhz.txt"

config USB0_ENABLE
    def_bool n

config MSC_ENABLE
    def_bool n

config FS_FAT
    def_bool n

config TASK_DRIVE_PROBE
    def_bool n

config SARADC_ENABLE
    def_bool y

config SARADC_CALIBRATION_ENABLE
    def_bool y

source "$CMAKE_SOURCE_DIR/sdk/Kconfig"

menu "Test SARADC"

choice
    prompt "SARADC TEST"
    default TEST_ALL_XAIN
    help
        Test SARADC module.

config TEST_ALL_XAIN
    bool "Test all XAIN"
    help
        Test all XAIN GPIO.

config TEST_KEYPAD_16KEY
    bool "Test 16Key keypad"
    help
        Test 16Key keypad through one XAIN only.

endchoice

endmenu
```

## project/test_saradc/Kconfig.win32
```kconfig
#
# For a description of the syntax of this configuration file,
# see Documentation/kbuild/kconfig-language.txt.
#

mainmenu "Project Configuration"

config DEF_CHIP_PKG_IT976
    def_bool y

config CMAKE_SOURCE_DIR
    string
    option env="CMAKE_SOURCE_DIR"

config SARADC_ENABLE
    def_bool y

source "$CMAKE_SOURCE_DIR/sdk/Kconfig"

menu "Test SARADC"

choice
    prompt "SARADC TEST"
    default TEST_ALL_XAIN
    help
        Test SARADC module.

config TEST_ALL_XAIN
    bool "Test all XAIN"
    help
        Test all XAIN GPIO.

config TEST_KEYPAD_16KEY
    bool "Test 16Key keypad"
    help
        Test 16Key keypad through one XAIN only.

endchoice

endmenu
```
